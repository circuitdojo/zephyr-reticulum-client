## CMakeLists.txt
```
cmake_minimum_required(VERSION 3.20.0)

# Register ret-client as a module whether or not the active west manifest
# lists it. Zephyr keys modules by name, so this is harmless when west
# already provides it.
list(APPEND ZEPHYR_EXTRA_MODULES ${CMAKE_CURRENT_SOURCE_DIR}/../..)

find_package(Zephyr REQUIRED HINTS $ENV{ZEPHYR_BASE})
project(ret_lxmf)

target_sources(app PRIVATE src/main.c)

if(CONFIG_NRF_MODEM_LIB)
    target_sources(app PRIVATE src/network_modem.c)
else()
    target_sources(app PRIVATE src/network_sim.c)
endif()
```

## Kconfig
```
# Copyright (c) 2026 Circuit Dojo LLC
# SPDX-License-Identifier: LicenseRef-Reticulum

menu "ret_lxmf sample"

config RET_LXMF_SAMPLE_DISPLAY_NAME
	string "Display name announced with the LXMF address"
	default "ret-lxmf"

config RET_LXMF_SAMPLE_CONTACT
	string "LXMF address to message (32 hex digits)"
	default ""
	help
	  When set, the sample sends "hello #n" to this lxmf.delivery
	  address every RET_LXMF_SAMPLE_SEND_INTERVAL_S seconds; a path is
	  requested on demand. Empty: only receive.

config RET_LXMF_SAMPLE_PROPAGATION_NODE
	string "LXMF propagation node to collect messages from (32 hex digits)"
	default ""
	help
	  The node's lxmf.propagation destination hash (lxmd prints it,
	  NomadNet lists it). Messages that arrived there while the sample
	  was offline are collected on every connect, and every
	  RET_LXMF_SAMPLE_SYNC_INTERVAL_S if that is set. Point senders at
	  the same node (or one it peers with).

config RET_LXMF_SAMPLE_SYNC_INTERVAL_S
	int "Seconds between propagation syncs while connected (0 = connect only)"
	default 0

config RET_LXMF_SAMPLE_SYNC_AND_EXIT
	bool "Sync once and exit (native_sim, for tests)"
	help
	  Connect, sync with RET_LXMF_SAMPLE_PROPAGATION_NODE once, log
	  "SYNC DONE <status> <messages>" and exit with status 0 if the sync
	  succeeded. Sends nothing. For tools/run_e2e.sh.

config RET_LXMF_SAMPLE_REPLY
	bool "Answer every received message"
	default y
	help
	  Reply "re: <content>" to the sender of each verified message
	  received, except to replies ("re: ..."), so two auto-repliers do
	  not answer each other forever.

config RET_LXMF_SAMPLE_SEND_INTERVAL_S
	int "Seconds between messages"
	default 30

config RET_LXMF_SAMPLE_MESSAGE_COUNT
	int "Messages to send (0 = forever)"
	default 0
	help
	  With a count, once every message has resolved and an
	  "echo: hello #n" reply arrived (verified) for each, or
	  RET_LXMF_SAMPLE_REPLY_WAIT_S passed, the sample logs a summary
	  and, on native_sim, exits with status 0 on full success and 1
	  otherwise. For tools/rns_peer/lxmf_peer.py.

config RET_LXMF_SAMPLE_REPLY_WAIT_S
	int "Seconds to wait for outstanding echoes"
	default 20

endmenu

source "Kconfig.zephyr"
```

## prj.conf
```kconfig
CONFIG_MAIN_STACK_SIZE=4096
CONFIG_HEAP_MEM_POOL_SIZE=4096

CONFIG_NETWORKING=y
CONFIG_NET_SOCKETS=y
CONFIG_NET_IPV4=y
CONFIG_NET_TCP=y

CONFIG_RET_CLIENT=y

# Settings keep the client's identity, and so its address, across reboots.
# Each board conf picks the backend (RET_CLIENT selects SETTINGS).

CONFIG_LOG=y
CONFIG_RET_LOG_LEVEL_INF=y
```

## boards/circuitdojo_feather_nrf9151_ns.conf
```kconfig
# nRF9151 Feather: TCP over the modem's offloaded sockets (like NSOS on
# native_sim, the client sees plain BSD sockets), PSA Crypto from TF-M.
CONFIG_NET_SOCKETS_OFFLOAD=y
CONFIG_NET_IPV6=y
CONFIG_NET_IPV6_NBR_CACHE=n
CONFIG_NET_IPV6_MLD=n

# The modem runs TCP/IP and DNS (sockets and getaddrinfo go to it). Zephyr's
# native stack stays only because the LTE net_if (NRF_MODEM_LIB_NET_IF)
# records the modem's addresses on the interface through it; everything
# else is trimmed (about 16 KB of RAM). Native TCP off: the TCP socket is
# the modem's. Native UDP stays: Zephyr's IP core does not build without
# one transport.
CONFIG_NET_TCP=n
CONFIG_NET_MAX_CONN=1
CONFIG_NET_MAX_CONTEXTS=1
CONFIG_NET_PKT_RX_COUNT=2
CONFIG_NET_PKT_TX_COUNT=2
CONFIG_NET_BUF_RX_COUNT=4
CONFIG_NET_BUF_TX_COUNT=4

# Modem: bring LTE up at boot; the connection manager reports L4 up/down.
CONFIG_NRF_MODEM_LIB=y
CONFIG_NRF_MODEM_LIB_NET_IF=y
CONFIG_NRF_MODEM_LIB_NET_IF_AUTO_START=y
CONFIG_NRF_MODEM_LIB_NET_IF_AUTO_CONNECT=y
CONFIG_NET_CONNECTION_MANAGER=y
CONFIG_NET_CONNECTION_MANAGER_MONITOR_STACK_SIZE=1024
CONFIG_AT_MONITOR_HEAP_SIZE=1024

# TF-M provides PSA Crypto to the non-secure app. NCS's minimal TF-M
# profile builds the secure image with random generation only and ignores
# PSA_WANT_* (SHA-256, HMAC and AES-CBC calls then fail with
# PSA_ERROR_NOT_SUPPORTED), so use the configurable profile.
CONFIG_TFM_PROFILE_TYPE_NOT_SET=y
# TF-M's 128 kB slot is in the flash layout:
# samples/common/circuitdojo_feather_nrf9151_ns_flash.dtsi.

# The board's startup code configures the nPM1300 PMIC through its MFD
# driver, so that stays; the charger and sensor drivers are not used.
CONFIG_NPM13XX_CHARGER=n
CONFIG_STS4X=n

# Settings in a file on LittleFS on the external W25Q128 NOR flash (the
# board's devicetree mounts it at /lfs), as in lion_sleep. Internal flash
# holds only firmware, so a re-layout or reflash cannot take the client's
# identity (its address) with it. At the mount root: the file backend
# creates the file but not parent directories.
CONFIG_SPI=y
CONFIG_SPI_NOR=y
CONFIG_SPI_NOR_FLASH_LAYOUT_PAGE_SIZE=4096
# Read the flash geometry from the chip's SFDP tables. nfed revisions
# before the jared/nor-flash-size fix declare the W25Q128 as 2 MiB (its
# devicetree `size` is in bits); with those, this is what makes the 16 MiB
# LittleFS work.
CONFIG_SPI_NOR_SFDP_RUNTIME=y
CONFIG_FLASH=y
CONFIG_FLASH_MAP=y
CONFIG_FLASH_PAGE_LAYOUT=y
CONFIG_FILE_SYSTEM=y
CONFIG_FILE_SYSTEM_LITTLEFS=y
CONFIG_SETTINGS_FILE=y
CONFIG_SETTINGS_FILE_PATH="/lfs/ret-settings"
# The file backend rewrites the whole file once it holds more lines than
# this. LXMF replay protection keeps ~70 keys (CONFIG_RET_LXMF_SEEN_ENTRIES
# plus identity, clock, floor): at the default 32 every received message
# would rewrite the file; at 512 it is about once per 450 messages.
CONFIG_SETTINGS_FILE_MAX_LINES=512

# Stack use every 60 s. Measured on hardware: ret_client peaks at 2632 of
# its 6144 bytes (42 %) through decrypt, proof signing and announce checks.
CONFIG_THREAD_ANALYZER=y
CONFIG_THREAD_ANALYZER_AUTO=y
CONFIG_THREAD_ANALYZER_AUTO_INTERVAL=60
CONFIG_THREAD_NAME=y
# Immediate logging: deferred logging drops the first lines of the
# analyzer's burst (printk goes through the same buffer) and can lose a
# fault report before a reset.
CONFIG_LOG_MODE_IMMEDIATE=y

# LXMF timestamps are wall-clock time: the date_time library sets
# SYS_CLOCK_REALTIME from the network's time (modem), and from NTP when
# the network sends none.
CONFIG_DATE_TIME=y
CONFIG_DATE_TIME_MODEM=y
CONFIG_DATE_TIME_NTP=y
```

## boards/native_sim.conf
```kconfig
# Host BSD sockets (NSOS): reaches rnsd on 127.0.0.1 with no TAP
# interface or root. Like the nRF91 modem, sockets are offloaded, so the
# client exercises the same socket path it will on hardware.
CONFIG_NET_DRIVERS=y
CONFIG_NET_SOCKETS_OFFLOAD=y
CONFIG_NET_NATIVE_OFFLOADED_SOCKETS=y

# Embedded libc so eventfd is Zephyr's, not the host's (as in lion-client).
CONFIG_PICOLIBC=y

# PSA Crypto from Zephyr's mbedTLS (never NRF_SECURITY on native_sim).
CONFIG_MBEDTLS=y
CONFIG_MBEDTLS_BUILTIN=y
CONFIG_MBEDTLS_ENABLE_HEAP=y
CONFIG_MBEDTLS_HEAP_SIZE=8192

# Settings in NVS on the simulated flash, which is a file: select it with
# --flash=<path>.
CONFIG_FLASH=y
CONFIG_FLASH_MAP=y
CONFIG_NVS=y
CONFIG_SETTINGS_NVS=y

CONFIG_RET_SERVER_HOST="127.0.0.1"
CONFIG_RET_SERVER_PORT=4242

# NSOS needs no Ethernet; keep the TAP driver from trying to create zeth.
CONFIG_ETH_NATIVE_TAP=n
```

## boards/circuitdojo_feather_nrf9151_ns.overlay
```dts
#include "../../common/circuitdojo_feather_nrf9151_ns_flash.dtsi"
```

## src/main.c
```c
/*
 * Copyright (c) 2026 Circuit Dojo LLC
 * SPDX-License-Identifier: LicenseRef-Reticulum
 *
 * An always-connected LXMF node: announces its lxmf.delivery address,
 * logs every message it receives (answering each when
 * CONFIG_RET_LXMF_SAMPLE_REPLY is set), and messages
 * CONFIG_RET_LXMF_SAMPLE_CONTACT periodically. ret_lxmf_send() picks the
 * method: opportunistic (one encrypted packet) when a message fits, DIRECT
 * (over a link to the recipient) when it does not, as a reply quoting a
 * long message does.
 */

#include <stdio.h>
#include <string.h>

#include <zephyr/kernel.h>
#include <zephyr/logging/log.h>
#include <zephyr/sys/util.h>

#include <ret/ret_client.h>

#include "network.h"

#if defined(CONFIG_ARCH_POSIX)
#include <nsi_main.h>
#endif

LOG_MODULE_REGISTER(ret_lxmf, LOG_LEVEL_INF);

#define ECHO_PREFIX  "echo: hello #"
#define REPLY_PREFIX "re: "
/* A reply quotes up to this much: longer than one packet, so it goes
 * DIRECT.
 */
#define REPLY_MAX MIN(1024, RET_LXMF_DIRECT_MAX_CONTENT)

static struct ret_client *client;
static K_SEM_DEFINE(connected_sem, 0, 1);

static uint8_t node[RET_DEST_HASH_LEN];
static bool has_node;
static K_SEM_DEFINE(sync_sem, 0, 1);
static int sync_status;
static void sync_work_fn(struct k_work *work);
static K_WORK_DELAYABLE_DEFINE(sync_work, sync_work_fn);

static atomic_t delivered;
static atomic_t resolved;
static K_SEM_DEFINE(resolved_sem, 0, K_SEM_MAX_LIMIT);
static atomic_t echoes;
static K_SEM_DEFINE(echo_sem, 0, K_SEM_MAX_LIMIT);

/* Replies are sent from the main thread: on_lxmf runs on the client
 * thread, and packing and signing want their own stack.
 */
struct reply {
	uint8_t to[RET_DEST_HASH_LEN];
	uint16_t len;
	char text[REPLY_MAX];
};
K_MSGQ_DEFINE(reply_q, sizeof(struct reply), 2, 4);

static void hex(const uint8_t *b, size_t n, char *out)
{
	for (size_t i = 0; i < n; i++) {
		sprintf(&out[2 * i], "%02x", b[i]);
	}
}

static void on_sync(int status, unsigned int received, void *user)
{
	ARG_UNUSED(user);
	LOG_INF("SYNC DONE %d %u", status, received);
	sync_status = status;
	k_sem_give(&sync_sem);
	if (CONFIG_RET_LXMF_SAMPLE_SYNC_INTERVAL_S > 0) {
		k_work_reschedule(&sync_work, K_SECONDS(CONFIG_RET_LXMF_SAMPLE_SYNC_INTERVAL_S));
	}
}

static void sync_work_fn(struct k_work *work)
{
	ARG_UNUSED(work);
	int err = ret_lxmf_sync(client, node, on_sync, NULL);

	if (err == -EAGAIN) {
		k_work_reschedule(&sync_work, K_SECONDS(1)); /* queue full: try again */
	} else if (err) {
		LOG_WRN("sync not started: %d", err);
	}
}

static void on_state(enum ret_client_state state, void *user)
{
	ARG_UNUSED(user);
	if (state == RET_STATE_CONNECTED) {
		LOG_INF("-> CONNECTED");
		k_sem_give(&connected_sem);
		/* Collect what arrived at the node while we were away. */
		if (has_node) {
			k_work_reschedule(&sync_work, K_NO_WAIT);
		}
	}
}

static void on_lxmf(const struct ret_lxmf_message *m, void *user)
{
	char src[2 * RET_DEST_HASH_LEN + 1];

	ARG_UNUSED(user);
	hex(m->source, RET_DEST_HASH_LEN, src);
	char title[65];
	char content[65];

	/* Copies, zero-terminated: deferred logging copies a %s argument up
	 * to its terminator, whatever the precision, and LXMF fields have none.
	 */
	snprintf(title, sizeof(title), "%.*s", (int)MIN(m->title_len, 64), (const char *)m->title);
	snprintf(content, sizeof(content), "%.*s", (int)MIN(m->content_len, 64),
		 (const char *)m->content);
	LOG_INF("LXMF RECEIVED %s from %s: %s|%s (%u bytes)", m->verified ? "verified" : "UNVERIFIED",
		src, title, content, (unsigned int)m->content_len);

	if (m->verified && m->content_len >= strlen(ECHO_PREFIX) &&
	    memcmp(m->content, ECHO_PREFIX, strlen(ECHO_PREFIX)) == 0) {
		atomic_inc(&echoes);
		k_sem_give(&echo_sem);
	}

	/* Answer verified messages only (a forged source would have us
	 * message any address), and never a reply: two auto-repliers would
	 * otherwise talk forever.
	 */
	if (IS_ENABLED(CONFIG_RET_LXMF_SAMPLE_REPLY) && m->verified &&
	    !(m->content_len >= strlen(REPLY_PREFIX) &&
	      memcmp(m->content, REPLY_PREFIX, strlen(REPLY_PREFIX)) == 0)) {
		/* static: the client thread's only, and kept off its stack. */
		static struct reply r;
		size_t room = sizeof(r.text) - strlen(REPLY_PREFIX);

		memcpy(r.to, m->source, sizeof(r.to));
		memcpy(r.text, REPLY_PREFIX, strlen(REPLY_PREFIX));
		memcpy(&r.text[strlen(REPLY_PREFIX)], m->content, MIN(m->content_len, room));
		r.len = (uint16_t)(strlen(REPLY_PREFIX) + MIN(m->content_len, room));
		if (k_msgq_put(&reply_q, &r, K_NO_WAIT) != 0) {
			LOG_WRN("reply queue full");
		}
	}
}

static void on_receipt(const uint8_t packet_hash[RET_PACKET_HASH_LEN],
		       enum ret_receipt_status status, uint32_t rtt_ms, void *user)
{
	int n = (int)(intptr_t)user;

	ARG_UNUSED(packet_hash);
	switch (status) {
	case RET_RECEIPT_DELIVERED:
		LOG_INF("LXMF DELIVERED #%d rtt=%u ms", n, rtt_ms);
		if (n > 0) {
			atomic_inc(&delivered);
		}
		break;
	case RET_RECEIPT_TIMEOUT:
		LOG_WRN("LXMF NOT PROVED #%d", n);
		break;
	case RET_RECEIPT_REJECTED:
		LOG_WRN("LXMF REJECTED #%d", n);
		break;
	default:
		LOG_WRN("LXMF FAILED #%d (%d)", n, status);
		break;
	}
	if (n > 0) {
		atomic_inc(&resolved);
		k_sem_give(&resolved_sem);
	}
}

/* Send queued replies (receipt user 0), waiting up to @p timeout for one. */
static void send_replies(k_timeout_t timeout)
{
	static struct reply r; /* main thread only */

	while (k_msgq_get(&reply_q, &r, timeout) == 0) {
		int err = ret_lxmf_send(client, r.to, NULL, 0, (const uint8_t *)r.text, r.len,
					on_receipt, (void *)(intptr_t)0);

		if (err) {
			LOG_ERR("reply not sent: %d", err);
		} else {
			char text[65];

			snprintf(text, sizeof(text), "%.*s", (int)MIN(r.len, 64), r.text);
			LOG_INF("REPLY SENT %s (%u bytes)", text, r.len);
		}
		timeout = K_NO_WAIT;
	}
}

static void finish(int sent)
{
	int ok = (int)atomic_get(&delivered);
	int64_t until = k_uptime_get() + CONFIG_RET_LXMF_SAMPLE_REPLY_WAIT_S * MSEC_PER_SEC;

	while (atomic_get(&echoes) < sent && k_uptime_get() < until) {
		send_replies(K_NO_WAIT);
		k_sem_take(&echo_sem, K_MSEC(MIN(until - k_uptime_get(), 200)));
	}
	/* Answer the last echoes too, and give their proofs a moment. */
	send_replies(K_NO_WAIT);
	k_sleep(K_SECONDS(3));

	bool success = ok == sent && atomic_get(&echoes) == sent;

	LOG_INF("DONE %d/%d delivered, %d/%d echoes", ok, sent, (int)atomic_get(&echoes), sent);
#if defined(CONFIG_ARCH_POSIX)
	k_sleep(K_MSEC(100)); /* let the log thread flush */
	nsi_exit(success ? 0 : 1);
#else
	ARG_UNUSED(success);
#endif
}

int main(void)
{
	static const struct ret_client_config cfg = {
		.on_state = on_state,
		.on_lxmf = on_lxmf,
		.lxmf_display_name = CONFIG_RET_LXMF_SAMPLE_DISPLAY_NAME,
	};
	uint8_t contact[RET_DEST_HASH_LEN];
	bool has_contact = strlen(CONFIG_RET_LXMF_SAMPLE_CONTACT) > 0;
	uint8_t own[RET_DEST_HASH_LEN];
	char own_hex[2 * RET_DEST_HASH_LEN + 1];
	char msg[32];
	int err;

	if (has_contact &&
	    hex2bin(CONFIG_RET_LXMF_SAMPLE_CONTACT, strlen(CONFIG_RET_LXMF_SAMPLE_CONTACT), contact,
		    sizeof(contact)) != sizeof(contact)) {
		LOG_ERR("RET_LXMF_SAMPLE_CONTACT must be 32 hex digits");
		return -EINVAL;
	}

	has_node = strlen(CONFIG_RET_LXMF_SAMPLE_PROPAGATION_NODE) > 0;
	if (has_node && hex2bin(CONFIG_RET_LXMF_SAMPLE_PROPAGATION_NODE,
				strlen(CONFIG_RET_LXMF_SAMPLE_PROPAGATION_NODE), node,
				sizeof(node)) != sizeof(node)) {
		LOG_ERR("RET_LXMF_SAMPLE_PROPAGATION_NODE must be 32 hex digits");
		return -EINVAL;
	}

	client = ret_client_create(&cfg);
	wait_for_network();

	err = ret_client_start(client);
	if (err) {
		LOG_ERR("ret_client_start failed: %d", err);
		return err;
	}
	if (ret_client_dest_hash(client, own) == 0) {
		hex(own, sizeof(own), own_hex);
		LOG_INF("LXMF ADDRESS %s (%s)", own_hex, CONFIG_RET_LXMF_SAMPLE_DISPLAY_NAME);
	}
	k_sem_take(&connected_sem, K_FOREVER);

#if defined(CONFIG_RET_LXMF_SAMPLE_SYNC_AND_EXIT)
	k_sem_take(&sync_sem, K_FOREVER);
	/* Path responses for unverified senders, whose keys are then kept. */
	k_sleep(K_SECONDS(1));
#if defined(CONFIG_ARCH_POSIX)
	nsi_exit(sync_status == 0 ? 0 : 1);
#endif
	return 0;
#endif

	if (!has_contact) {
		for (;;) {
			send_replies(K_FOREVER);
		}
	}

	for (int n = 1; CONFIG_RET_LXMF_SAMPLE_MESSAGE_COUNT == 0 ||
			n <= CONFIG_RET_LXMF_SAMPLE_MESSAGE_COUNT;
	     n++) {
		int len = snprintf(msg, sizeof(msg), "hello #%d", n);
		int64_t next = k_uptime_get() + CONFIG_RET_LXMF_SAMPLE_SEND_INTERVAL_S * MSEC_PER_SEC;

		err = ret_lxmf_send(client, contact, NULL, 0, (const uint8_t *)msg, len, on_receipt,
				    (void *)(intptr_t)n);
		if (err) {
			LOG_ERR("message #%d not sent: %d", n, err);
			atomic_inc(&resolved);
		} else {
			LOG_INF("LXMF SENT %s", msg);
		}
		while (k_uptime_get() < next) {
			send_replies(K_MSEC(next - k_uptime_get()));
		}
	}

	while (atomic_get(&resolved) < CONFIG_RET_LXMF_SAMPLE_MESSAGE_COUNT) {
		send_replies(K_NO_WAIT);
		k_sem_take(&resolved_sem, K_MSEC(200));
	}
	finish(CONFIG_RET_LXMF_SAMPLE_MESSAGE_COUNT);
	return 0;
}
```

## src/network.h
```c
/*
 * Copyright (c) 2026 Circuit Dojo LLC
 * SPDX-License-Identifier: Apache-2.0
 */

#ifndef NETWORK_H_
#define NETWORK_H_

/** Block until the network is up (LTE on the modem; no-op on native_sim). */
void wait_for_network(void);

#endif /* NETWORK_H_ */
```

## src/network_modem.c
```c
/*
 * Copyright (c) 2026 Circuit Dojo LLC
 * SPDX-License-Identifier: LicenseRef-Reticulum
 */

#include <date_time.h>
#include <zephyr/kernel.h>
#include <zephyr/logging/log.h>
#include <zephyr/net/conn_mgr_monitor.h>
#include <zephyr/net/net_event.h>
#include <zephyr/net/net_mgmt.h>

#include "network.h"

LOG_MODULE_REGISTER(network, LOG_LEVEL_INF);

static K_SEM_DEFINE(l4_up, 0, 1);
static K_SEM_DEFINE(time_known, 0, 1);
static struct net_mgmt_event_callback l4_cb;

static void l4_handler(struct net_mgmt_event_callback *cb, uint64_t event,
		       struct net_if *iface)
{
	ARG_UNUSED(cb);
	ARG_UNUSED(iface);

	if (event == NET_EVENT_L4_CONNECTED) {
		LOG_INF("LTE connected");
		k_sem_give(&l4_up);
	} else if (event == NET_EVENT_L4_DISCONNECTED) {
		/* The client notices on its own and reconnects when LTE returns. */
		LOG_WRN("LTE disconnected");
	}
}

static void date_time_handler(const struct date_time_evt *evt)
{
	if (evt->type != DATE_TIME_NOT_OBTAINED) {
		k_sem_give(&time_known);
	}
}

void wait_for_network(void)
{
	net_mgmt_init_event_callback(&l4_cb, l4_handler,
				     NET_EVENT_L4_CONNECTED | NET_EVENT_L4_DISCONNECTED);
	net_mgmt_add_event_callback(&l4_cb);
	/* Replays the current state, in case LTE came up before we listened. */
	conn_mgr_mon_resend_status();

	LOG_INF("waiting for LTE...");
	k_sem_take(&l4_up, K_FOREVER);

	/* LXMF timestamps are wall-clock time: wait until date_time has it. */
	date_time_register_handler(date_time_handler);
	if (!date_time_is_valid()) {
		LOG_INF("waiting for network time...");
		(void)date_time_update_async(date_time_handler);
		k_sem_take(&time_known, K_FOREVER);
	}
	LOG_INF("wall clock set");
}
```
