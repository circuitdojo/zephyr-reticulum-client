## CMakeLists.txt
```
cmake_minimum_required(VERSION 3.20.0)

# Register ret-client as a module whether or not the active west manifest
# lists it. Zephyr keys modules by name, so this is harmless when west
# already provides it.
list(APPEND ZEPHYR_EXTRA_MODULES ${CMAKE_CURRENT_SOURCE_DIR}/../..)

find_package(Zephyr REQUIRED HINTS $ENV{ZEPHYR_BASE})
project(ret_chat)

target_sources(app PRIVATE src/main.c src/chat.c src/chat_shell.c)

if(CONFIG_NRF_MODEM_LIB)
    target_sources(app PRIVATE src/network_modem.c)
else()
    target_sources(app PRIVATE src/network_sim.c)
endif()
```

## Kconfig
```
# Copyright (c) 2026 Circuit Dojo LLC
# SPDX-License-Identifier: LicenseRef-Reticulum

menu "ret_chat sample"

config CHAT_DISPLAY_NAME
	string "Display name announced with the LXMF address"
	default "ret-chat"

config CHAT_PROPAGATION_NODE
	string "LXMF propagation node to collect messages from (32 hex digits)"
	default ""
	help
	  The node's lxmf.propagation hash (lxmd logs it; see
	  tools/lxmd-hw). Messages held there are collected on every
	  connect and with the 'sync' command. Empty: no sync.

config CHAT_CONTACTS
	int "Contacts kept (settings chat/ct/<n>)"
	default 16
	range 1 256

config CHAT_HEARD
	int "LXMF addresses heard announcing, kept since boot"
	default 8
	range 1 64

config CHAT_INBOX_BYTES
	int "Inbox size in bytes (RAM only, oldest messages evicted)"
	default 4096
	range 512 65536
	help
	  Received titles and contents, never written to flash. A message
	  larger than this keeps its first part.

config CHAT_INBOX_MESSAGES
	int "Messages the inbox holds at most"
	default 16
	range 1 256

endmenu

source "Kconfig.zephyr"
```

## prj.conf
```kconfig
# main starts things: settings (LittleFS on the board), the identity and
# ratchet on first boot, the client.
CONFIG_MAIN_STACK_SIZE=4096
CONFIG_HEAP_MEM_POOL_SIZE=4096

CONFIG_NETWORKING=y
CONFIG_NET_SOCKETS=y
CONFIG_NET_IPV4=y
CONFIG_NET_TCP=y

CONFIG_RET_CLIENT=y

# Settings keep the client's identity (its address) and the contacts
# across reboots. Each board conf picks the backend.

# The shell on the console UART. Logs go through it too, so a message
# arriving while you type does not garble the line.
CONFIG_SHELL=y
CONFIG_SHELL_BACKEND_SERIAL=y
CONFIG_SHELL_LOG_BACKEND=y
CONFIG_SHELL_PROMPT_UART="chat> "
# 'msg send' packs and signs on the shell thread (about 1.5 KB), and
# 'contact add' writes settings from it.
CONFIG_SHELL_STACK_SIZE=4096
# Room for a message of a few hundred bytes typed or pasted on one line.
CONFIG_SHELL_CMD_BUFF_SIZE=512
CONFIG_SHELL_HISTORY_BUFFER=256
CONFIG_SHELL_WILDCARD=n
CONFIG_KERNEL_SHELL=n
CONFIG_DEVICE_SHELL=n

CONFIG_LOG=y
CONFIG_RET_LOG_LEVEL_INF=y
```

## boards/circuitdojo_feather_nrf9151_ns.conf
```kconfig
# nRF9151 Feather: TCP over the modem's offloaded sockets (like NSOS on
# native_sim, the client sees plain BSD sockets), PSA Crypto from TF-M.
CONFIG_NET_SOCKETS_OFFLOAD=y
CONFIG_NET_IPV6=y
CONFIG_NET_IPV6_NBR_CACHE=n
CONFIG_NET_IPV6_MLD=n

# The modem runs TCP/IP and DNS (sockets and getaddrinfo go to it). Zephyr's
# native stack stays only because the LTE net_if (NRF_MODEM_LIB_NET_IF)
# records the modem's addresses on the interface through it; everything
# else is trimmed (about 16 KB of RAM). Native TCP off: the TCP socket is
# the modem's. Native UDP stays: Zephyr's IP core does not build without
# one transport.
CONFIG_NET_TCP=n
CONFIG_NET_MAX_CONN=1
CONFIG_NET_MAX_CONTEXTS=1
CONFIG_NET_PKT_RX_COUNT=2
CONFIG_NET_PKT_TX_COUNT=2
CONFIG_NET_BUF_RX_COUNT=4
CONFIG_NET_BUF_TX_COUNT=4

# Modem: bring LTE up at boot; the connection manager reports L4 up/down.
CONFIG_NRF_MODEM_LIB=y
CONFIG_NRF_MODEM_LIB_NET_IF=y
CONFIG_NRF_MODEM_LIB_NET_IF_AUTO_START=y
CONFIG_NRF_MODEM_LIB_NET_IF_AUTO_CONNECT=y
CONFIG_NET_CONNECTION_MANAGER=y
CONFIG_NET_CONNECTION_MANAGER_MONITOR_STACK_SIZE=1024
CONFIG_AT_MONITOR_HEAP_SIZE=1024

# TF-M provides PSA Crypto to the non-secure app. NCS's minimal TF-M
# profile builds the secure image with random generation only and ignores
# PSA_WANT_* (SHA-256, HMAC and AES-CBC calls then fail with
# PSA_ERROR_NOT_SUPPORTED), so use the configurable profile.
CONFIG_TFM_PROFILE_TYPE_NOT_SET=y
# TF-M's 128 kB slot is in the flash layout:
# samples/common/circuitdojo_feather_nrf9151_ns_flash.dtsi.

# The board's startup code configures the nPM1300 PMIC through its MFD
# driver, so that stays; the charger and sensor drivers are not used.
CONFIG_NPM13XX_CHARGER=n
CONFIG_STS4X=n

# Settings in a file on LittleFS on the external W25Q128 NOR flash (the
# board's devicetree mounts it at /lfs), as in lion_sleep. Internal flash
# holds only firmware, so a re-layout or reflash cannot take the client's
# identity (its address) with it. At the mount root: the file backend
# creates the file but not parent directories.
CONFIG_SPI=y
CONFIG_SPI_NOR=y
CONFIG_SPI_NOR_FLASH_LAYOUT_PAGE_SIZE=4096
# Read the flash geometry from the chip's SFDP tables. nfed revisions
# before the jared/nor-flash-size fix declare the W25Q128 as 2 MiB (its
# devicetree `size` is in bits); with those, this is what makes the 16 MiB
# LittleFS work.
CONFIG_SPI_NOR_SFDP_RUNTIME=y
CONFIG_FLASH=y
CONFIG_FLASH_MAP=y
CONFIG_FLASH_PAGE_LAYOUT=y
CONFIG_FILE_SYSTEM=y
CONFIG_FILE_SYSTEM_LITTLEFS=y
CONFIG_SETTINGS_FILE=y
CONFIG_SETTINGS_FILE_PATH="/lfs/ret-settings"
# The file backend rewrites the whole file once it holds more lines than
# this. LXMF replay protection keeps ~70 keys (CONFIG_RET_LXMF_SEEN_ENTRIES
# plus identity, clock, floor): at the default 32 every received message
# would rewrite the file; at 512 it is about once per 450 messages.
CONFIG_SETTINGS_FILE_MAX_LINES=512

# Stack use on demand, from the shell: 'kernel thread stacks' (the shell
# thread's peak comes from 'msg send' and 'contact add').
CONFIG_KERNEL_SHELL=y
CONFIG_THREAD_STACK_INFO=y
CONFIG_INIT_STACKS=y
CONFIG_THREAD_NAME=y

# LXMF timestamps are wall-clock time: the date_time library sets
# SYS_CLOCK_REALTIME from the network's time (modem), and from NTP when
# the network sends none.
CONFIG_DATE_TIME=y
CONFIG_DATE_TIME_MODEM=y
CONFIG_DATE_TIME_NTP=y

# RAM: the client keeps a Resource stream buffer, a plaintext buffer and
# the DIRECT send pool, each RET_RESOURCE_MAX_SIZE (8 KB by default). At
# 4 KB this sample (shell, inbox) stays under 85% of the nRF9151's RAM;
# messages are then limited to about 3.9 KB each way, and a sync fetches
# batches of at most 3 KB (it must stay below the Resource size).
CONFIG_RET_RESOURCE_MAX_SIZE=4096
CONFIG_RET_LXMF_SYNC_LIMIT_KB=3
```

## boards/native_sim.conf
```kconfig
# Host BSD sockets (NSOS): reaches rnsd on 127.0.0.1 with no TAP
# interface or root. Like the nRF91 modem, sockets are offloaded, so the
# client exercises the same socket path it will on hardware.
CONFIG_NET_DRIVERS=y
CONFIG_NET_SOCKETS_OFFLOAD=y
CONFIG_NET_NATIVE_OFFLOADED_SOCKETS=y

# Embedded libc so eventfd is Zephyr's, not the host's (as in lion-client).
CONFIG_PICOLIBC=y

# PSA Crypto from Zephyr's mbedTLS (never NRF_SECURITY on native_sim).
CONFIG_MBEDTLS=y
CONFIG_MBEDTLS_BUILTIN=y
CONFIG_MBEDTLS_ENABLE_HEAP=y
CONFIG_MBEDTLS_HEAP_SIZE=8192

# Settings in NVS on the simulated flash, which is a file: select it with
# --flash=<path>.
CONFIG_FLASH=y
CONFIG_FLASH_MAP=y
CONFIG_NVS=y
CONFIG_SETTINGS_NVS=y

CONFIG_RET_SERVER_HOST="127.0.0.1"
CONFIG_RET_SERVER_PORT=4242

# NSOS needs no Ethernet; keep the TAP driver from trying to create zeth.
CONFIG_ETH_NATIVE_TAP=n

# The shell's UART gets its own pseudoterminal (attach with
# --attach_uart, or screen on the /dev/pts it prints); --uart_stdinout
# puts it on stdin/stdout instead, as tools/run_e2e.sh does. Logs go
# through the shell only, not also to stdout.
CONFIG_LOG_BACKEND_NATIVE_POSIX=n
```

## src/main.c
```c
/*
 * Copyright (c) 2026 Circuit Dojo LLC
 * SPDX-License-Identifier: LicenseRef-Reticulum
 *
 * LXMF chat over the console: a shell to message contacts, read the
 * inbox and see who is around (chat_shell.c), over the chat layer
 * (chat.c). The shell runs from boot; the client starts once the network
 * and the wall clock are up, which 'status' shows meanwhile.
 */

#include <zephyr/kernel.h>
#include <zephyr/logging/log.h>
#include <zephyr/shell/shell.h>
#include <zephyr/shell/shell_uart.h>
#include <zephyr/sys/util.h>

#include <ret/ret_client.h>

#include "chat.h"
#include "network.h"

LOG_MODULE_REGISTER(ret_chat, LOG_LEVEL_INF);

int main(void)
{
	static struct ret_client_config cfg = {
		.lxmf_display_name = CONFIG_CHAT_DISPLAY_NAME,
	};
	struct ret_client *client;
	uint8_t own[RET_DEST_HASH_LEN];
	char own_hex[CHAT_HEX_LEN + 1];
	int err;

	/* Logs go through the shell, and ones made before it is up are
	 * dropped: wait for it (briefly), so the boot lines (address,
	 * ratchet) are seen.
	 */
	for (int i = 0; i < 100 && !shell_ready(shell_backend_uart_get_ptr()); i++) {
		k_sleep(K_MSEC(10));
	}

	err = chat_init();
	if (err) {
		return err;
	}
	chat_client_config(&cfg);
	client = ret_client_create(&cfg);

	wait_for_network();
	err = ret_client_start(client);
	if (err) {
		LOG_ERR("ret_client_start failed: %d", err);
		return err;
	}
	chat_set_client(client);
	if (ret_client_dest_hash(client, own) == 0) {
		bin2hex(own, sizeof(own), own_hex, sizeof(own_hex));
		LOG_INF("CHAT ADDRESS %s (%s)", own_hex, CONFIG_CHAT_DISPLAY_NAME);
	}
	return 0;
}
```

## src/chat.c
```c
/*
 * Copyright (c) 2026 Circuit Dojo LLC
 * SPDX-License-Identifier: LicenseRef-Reticulum
 */

#include <errno.h>
#include <stdio.h>
#include <stdlib.h>
#include <string.h>

#include <zephyr/kernel.h>
#include <zephyr/logging/log.h>
#include <zephyr/settings/settings.h>
#include <zephyr/sys/util.h>

#include "chat.h"
#include "network.h"

LOG_MODULE_REGISTER(chat, LOG_LEVEL_INF);

/* Guards everything below: the client thread (announces, messages,
 * receipts) and the front end (shell) both use it.
 */
static K_MUTEX_DEFINE(lock);

static struct ret_client *client;
static atomic_t state = ATOMIC_INIT(RET_STATE_DISCONNECTED);
static uint8_t lxmf_name_hash[10];
static uint8_t node[RET_DEST_HASH_LEN];
static bool has_node;
/* Contacts loaded: until then the shell (up before main) must not read or
 * write them, or 'contact add' could take a stored contact's slot.
 */
static atomic_t ready;

/* --- Contacts (settings chat/ct/<n>: name[16] | address[16]) ------------- */

#define CONTACT_RECORD_LEN (CHAT_NAME_MAX + RET_DEST_HASH_LEN)

static struct {
	bool used;
	struct chat_contact c;
} contacts[CONFIG_CHAT_CONTACTS];

/* --- Heard lxmf.delivery announces, in the order first heard ------------- */

static struct chat_heard heard[CONFIG_CHAT_HEARD];
static size_t n_heard;

/* --- Inbox: message headers in a ring, their bytes in a byte ring -------- */

#define TITLE_KEEP 64

static struct {
	struct chat_message m;
	uint32_t off; /* title then content, contiguous in inbox_buf */
} inbox[CONFIG_CHAT_INBOX_MESSAGES];
static size_t inbox_head;
static size_t inbox_count;
static size_t inbox_used; /* bytes held by live messages */
static uint32_t inbox_seq;
static uint8_t inbox_buf[CONFIG_CHAT_INBOX_BYTES];

/* --- Outbox: who each pending send went to, for its delivery line -------- */

static struct {
	uint32_t id;
	char label[CHAT_HEX_LEN + 1];
} outbox[16];
static uint32_t outbox_id;

static void hex(const uint8_t *b, size_t n, char *out)
{
	bin2hex(b, n, out, 2 * n + 1);
}

/* Callers hold the lock. */
static void label_locked(const uint8_t addr[RET_DEST_HASH_LEN], char *out, size_t cap)
{
	for (size_t i = 0; i < ARRAY_SIZE(contacts); i++) {
		if (contacts[i].used && memcmp(contacts[i].c.addr, addr, RET_DEST_HASH_LEN) == 0) {
			snprintf(out, cap, "%s", contacts[i].c.name);
			return;
		}
	}
	for (size_t i = 0; i < n_heard; i++) {
		if (memcmp(heard[i].addr, addr, RET_DEST_HASH_LEN) == 0 && heard[i].display[0]) {
			snprintf(out, cap, "%s", heard[i].display);
			return;
		}
	}
	if (cap > CHAT_HEX_LEN) {
		hex(addr, RET_DEST_HASH_LEN, out);
	} else if (cap > 0) {
		out[0] = '\0';
	}
}

void chat_label(const uint8_t addr[RET_DEST_HASH_LEN], char *out, size_t cap)
{
	k_mutex_lock(&lock, K_FOREVER);
	label_locked(addr, out, cap);
	k_mutex_unlock(&lock);
}

/* One line for the log: control characters (newlines too) as spaces, cut
 * at @p cap. Deferred logging copies a %s argument up to its terminator,
 * so the copy must be terminated.
 */
static void preview(const uint8_t *p, size_t len, char *out, size_t cap)
{
	size_t n = MIN(len, cap - 1);

	for (size_t i = 0; i < n; i++) {
		out[i] = p[i] < 0x20 || p[i] == 0x7f ? ' ' : (char)p[i];
	}
	out[n] = '\0';
}

/* --- Client callbacks (client thread) ------------------------------------ */

static void sync_work_fn(struct k_work *work);
static K_WORK_DELAYABLE_DEFINE(sync_work, sync_work_fn);

static void on_state(enum ret_client_state s, void *user)
{
	ARG_UNUSED(user);
	atomic_set(&state, s);
	if (s == RET_STATE_CONNECTED) {
		LOG_INF("connected");
		/* Collect what arrived at the node while we were away. */
		if (has_node) {
			k_work_reschedule(&sync_work, K_NO_WAIT);
		}
	} else if (s == RET_STATE_RECONNECTING) {
		LOG_WRN("connection lost: reconnecting");
	}
}

static void on_announce(const struct ret_announce_info *a, void *user)
{
	struct chat_heard h = { .hops = a->hops, .uptime_ms = k_uptime_get() };
	size_t at;

	ARG_UNUSED(user);
	if (memcmp(a->name_hash, lxmf_name_hash, sizeof(lxmf_name_hash)) != 0) {
		return;
	}
	memcpy(h.addr, a->dest_hash, RET_DEST_HASH_LEN);
	/* No name, or one LXMF could not display either: listed without. */
	if (ret_lxmf_display_name(a->app_data, a->app_data_len, h.display, sizeof(h.display)) < 0) {
		h.display[0] = '\0';
	}
	/* It is printed to a terminal: no control characters from the network. */
	for (char *p = h.display; *p; p++) {
		if ((uint8_t)*p < 0x20 || *p == 0x7f) {
			*p = '?';
		}
	}

	/* Entries stay where they are, so "#n" means the same address from
	 * one 'heard' to the next: a repeat updates in place, a newcomer takes
	 * a free entry, or the one heard least recently.
	 */
	k_mutex_lock(&lock, K_FOREVER);
	for (at = 0; at < n_heard; at++) {
		if (memcmp(heard[at].addr, h.addr, RET_DEST_HASH_LEN) == 0) {
			break;
		}
	}
	if (at == n_heard && n_heard < ARRAY_SIZE(heard)) {
		n_heard++;
	} else if (at == n_heard) {
		at = 0;
		for (size_t i = 1; i < n_heard; i++) {
			if (heard[i].uptime_ms < heard[at].uptime_ms) {
				at = i;
			}
		}
	}
	heard[at] = h;
	k_mutex_unlock(&lock);
}

static void inbox_evict(void)
{
	inbox_used -= inbox[inbox_head].m.title_len + inbox[inbox_head].m.stored_len;
	inbox_head = (inbox_head + 1) % ARRAY_SIZE(inbox);
	inbox_count--;
}

/* Where @p need bytes go, evicting the oldest messages until they fit. */
static uint32_t inbox_place(size_t need)
{
	for (;;) {
		if (inbox_count == ARRAY_SIZE(inbox)) {
			inbox_evict();
			continue;
		}
		/* Nothing live holds bytes (none, or only empty messages, such
		 * as ones carrying fields alone): start over at 0.
		 */
		if (inbox_used == 0) {
			return 0;
		}

		size_t newest = (inbox_head + inbox_count - 1) % ARRAY_SIZE(inbox);
		size_t start = inbox[inbox_head].off;
		size_t end = inbox[newest].off + inbox[newest].m.title_len + inbox[newest].m.stored_len;

		if (start < end) {
			/* Not wrapped: free space after the newest, then before the oldest. */
			if (sizeof(inbox_buf) - end >= need) {
				return end;
			}
			if (start >= need) {
				return 0;
			}
		} else if (start > end && start - end >= need) {
			return end; /* wrapped: the gap between newest and oldest */
		}
		inbox_evict();
	}
}

static void on_lxmf(const struct ret_lxmf_message *m, void *user)
{
	size_t title_len = MIN(m->title_len, TITLE_KEEP);
	size_t stored = MIN(m->content_len, sizeof(inbox_buf) - title_len);
	char who[CHAT_HEX_LEN + 1];
	char text[41];
	uint32_t seq;

	ARG_UNUSED(user);

	k_mutex_lock(&lock, K_FOREVER);
	uint32_t off = inbox_place(title_len + stored);
	size_t slot = (inbox_head + inbox_count) % ARRAY_SIZE(inbox);

	seq = ++inbox_seq;
	inbox[slot].off = off;
	inbox[slot].m = (struct chat_message){
		.seq = seq,
		.timestamp = m->timestamp,
		.verified = m->verified,
		.title_len = (uint16_t)title_len,
		.content_len = (uint32_t)m->content_len,
		.stored_len = (uint32_t)stored,
	};
	memcpy(inbox[slot].m.source, m->source, RET_DEST_HASH_LEN);
	memcpy(&inbox_buf[off], m->title, title_len);
	memcpy(&inbox_buf[off + title_len], m->content, stored);
	inbox_count++;
	inbox_used += title_len + stored;
	label_locked(m->source, who, sizeof(who));
	k_mutex_unlock(&lock);

	preview(m->content, m->content_len, text, sizeof(text));
	LOG_INF("new message #%u from %s%s: %s%s", seq, who, m->verified ? "" : " (unverified)",
		text, m->content_len > sizeof(text) - 1 ? "..." : "");
}

static void on_receipt(const uint8_t packet_hash[RET_PACKET_HASH_LEN],
		       enum ret_receipt_status status, uint32_t rtt_ms, void *user)
{
	uint32_t id = (uint32_t)(uintptr_t)user;
	char who[CHAT_HEX_LEN + 1] = "?";

	ARG_UNUSED(packet_hash);
	k_mutex_lock(&lock, K_FOREVER);
	for (size_t i = 0; i < ARRAY_SIZE(outbox); i++) {
		if (outbox[i].id == id) {
			memcpy(who, outbox[i].label, sizeof(who));
		}
	}
	k_mutex_unlock(&lock);

	switch (status) {
	case RET_RECEIPT_DELIVERED:
		LOG_INF("sent #%u to %s: delivered (%u ms)", id, who, rtt_ms);
		break;
	case RET_RECEIPT_TIMEOUT:
		LOG_WRN("sent #%u to %s: not confirmed (no delivery proof)", id, who);
		break;
	case RET_RECEIPT_REJECTED:
		LOG_WRN("sent #%u to %s: rejected by the recipient", id, who);
		break;
	case RET_RECEIPT_DISCONNECTED:
		LOG_WRN("sent #%u to %s: connection dropped before delivery", id, who);
		break;
	default:
		LOG_WRN("sent #%u to %s: failed (no path to it, or not connected)", id, who);
		break;
	}
}

static void on_sync(int status, unsigned int received, void *user)
{
	ARG_UNUSED(user);
	if (status == 0) {
		LOG_INF("sync: %u new", received);
	} else {
		LOG_WRN("sync failed: %d", status);
	}
}

static void sync_work_fn(struct k_work *work)
{
	ARG_UNUSED(work);
	int err = chat_sync();

	if (err == -EAGAIN) {
		k_work_reschedule(&sync_work, K_SECONDS(1)); /* request queue full */
	} else if (err) {
		LOG_WRN("sync not started: %d", err);
	}
}

/* --- Setup ---------------------------------------------------------------- */

static int contact_load_cb(const char *key, size_t len, settings_read_cb read_cb, void *cb_arg,
			   void *param)
{
	uint8_t rec[CONTACT_RECORD_LEN];
	char *end;
	unsigned long slot = strtoul(key, &end, 10);

	ARG_UNUSED(param);
	if (key[0] < '0' || key[0] > '9' || *end != '\0' || slot >= ARRAY_SIZE(contacts) ||
	    len != sizeof(rec) || read_cb(cb_arg, rec, sizeof(rec)) != sizeof(rec)) {
		/* Expendable: skipped, and kept for a larger table. Returning
		 * an error would stop the load at this record.
		 */
		LOG_WRN("contact record chat/ct/%s skipped", key);
		return 0;
	}
	contacts[slot].used = true;
	memcpy(contacts[slot].c.name, rec, CHAT_NAME_MAX);
	contacts[slot].c.name[CHAT_NAME_MAX] = '\0';
	memcpy(contacts[slot].c.addr, &rec[CHAT_NAME_MAX], RET_DEST_HASH_LEN);
	return 0;
}

int chat_init(void)
{
	int err = ret_client_name_hash("lxmf.delivery", lxmf_name_hash);

	if (err) {
		return err;
	}
	has_node = strlen(CONFIG_CHAT_PROPAGATION_NODE) > 0;
	if (has_node && hex2bin(CONFIG_CHAT_PROPAGATION_NODE, strlen(CONFIG_CHAT_PROPAGATION_NODE),
				node, sizeof(node)) != sizeof(node)) {
		LOG_ERR("CHAT_PROPAGATION_NODE must be 32 hex digits");
		return -EINVAL;
	}
	err = settings_subsys_init();
	if (!err) {
		err = settings_load_subtree_direct("chat/ct", contact_load_cb, NULL);
	}
	if (err) {
		LOG_ERR("loading contacts failed: %d", err);
		return err;
	}

	size_t n = 0;

	for (size_t i = 0; i < ARRAY_SIZE(contacts); i++) {
		n += contacts[i].used;
	}
	atomic_set(&ready, 1);
	LOG_INF("%u contact(s) loaded", (unsigned int)n);
	return 0;
}

void chat_client_config(struct ret_client_config *cfg)
{
	cfg->on_state = on_state;
	cfg->on_announce = on_announce;
	cfg->on_lxmf = on_lxmf;
}

void chat_set_client(struct ret_client *c)
{
	client = c;
}

/* --- Front-end calls ------------------------------------------------------- */

int chat_resolve(const char *target, uint8_t addr[RET_DEST_HASH_LEN], char *label,
		 size_t label_cap)
{
	size_t len = strlen(target);
	int err = -ENOENT;

	if (!atomic_get(&ready)) {
		return -EBUSY;
	}
	k_mutex_lock(&lock, K_FOREVER);
	if (target[0] == '#') {
		char *end;
		unsigned long i = strtoul(&target[1], &end, 10);

		if (target[1] == '\0' || *end != '\0') {
			err = -EINVAL;
		} else if (i >= 1 && i <= n_heard) {
			memcpy(addr, heard[i - 1].addr, RET_DEST_HASH_LEN);
			err = 0;
		}
	} else if (len == CHAT_HEX_LEN && hex2bin(target, len, addr, RET_DEST_HASH_LEN) ==
						     RET_DEST_HASH_LEN) {
		err = 0;
	} else {
		for (size_t i = 0; i < ARRAY_SIZE(contacts); i++) {
			if (contacts[i].used && strcmp(contacts[i].c.name, target) == 0) {
				memcpy(addr, contacts[i].c.addr, RET_DEST_HASH_LEN);
				err = 0;
				break;
			}
		}
	}
	if (!err) {
		label_locked(addr, label, label_cap);
	}
	k_mutex_unlock(&lock);
	return err;
}

int chat_send(const uint8_t addr[RET_DEST_HASH_LEN], const char *text, size_t len, uint32_t *id,
	      bool *was_heard)
{
	char who[CHAT_HEX_LEN + 1];
	int err;

	if (client == NULL) {
		return -ENOTCONN;
	}

	k_mutex_lock(&lock, K_FOREVER);
	label_locked(addr, who, sizeof(who));
	*was_heard = false;
	for (size_t i = 0; i < n_heard; i++) {
		*was_heard |= memcmp(heard[i].addr, addr, RET_DEST_HASH_LEN) == 0;
	}
	*id = ++outbox_id;
	outbox[*id % ARRAY_SIZE(outbox)].id = *id;
	memcpy(outbox[*id % ARRAY_SIZE(outbox)].label, who, sizeof(who));
	k_mutex_unlock(&lock);

	/* Packs and signs here, on the caller's stack (about 1.5 KB). */
	err = ret_lxmf_send(client, addr, NULL, 0, (const uint8_t *)text, len, on_receipt,
			    (void *)(uintptr_t)*id);
	if (err) {
		k_mutex_lock(&lock, K_FOREVER);
		outbox_id--; /* not sent: the next one takes its number */
		k_mutex_unlock(&lock);
	}
	return err;
}

static bool name_ok(const char *name)
{
	size_t len = strlen(name);

	if (len == 0 || len > CHAT_NAME_MAX) {
		return false;
	}
	for (size_t i = 0; i < len; i++) {
		char c = name[i];

		if (!((c >= 'a' && c <= 'z') || (c >= 'A' && c <= 'Z') || (c >= '0' && c <= '9') ||
		      c == '_' || c == '-' || c == '.')) {
			return false;
		}
	}
	return true;
}

int chat_contact_add(const char *name, const uint8_t addr[RET_DEST_HASH_LEN])
{
	uint8_t rec[CONTACT_RECORD_LEN] = { 0 };
	char key[24]; /* "chat/ct/" and any int */
	int slot = -1;
	int err;

	if (!atomic_get(&ready)) {
		return -EBUSY;
	}
	if (!name_ok(name)) {
		return -EINVAL;
	}
	k_mutex_lock(&lock, K_FOREVER);
	for (size_t i = 0; i < ARRAY_SIZE(contacts); i++) {
		if (contacts[i].used && strcmp(contacts[i].c.name, name) == 0) {
			k_mutex_unlock(&lock);
			return -EEXIST;
		}
		if (!contacts[i].used && slot < 0) {
			slot = (int)i;
		}
	}
	if (slot < 0) {
		k_mutex_unlock(&lock);
		return -ENOSPC;
	}
	k_mutex_unlock(&lock);

	/* Written without the lock, so the client thread never waits on
	 * flash. Contacts change only from the front end (one thread).
	 */
	memcpy(rec, name, strlen(name));
	memcpy(&rec[CHAT_NAME_MAX], addr, RET_DEST_HASH_LEN);
	snprintf(key, sizeof(key), "chat/ct/%d", slot);
	err = settings_save_one(key, rec, sizeof(rec));
	if (!err) {
		k_mutex_lock(&lock, K_FOREVER);
		contacts[slot].used = true;
		strcpy(contacts[slot].c.name, name);
		memcpy(contacts[slot].c.addr, addr, RET_DEST_HASH_LEN);
		k_mutex_unlock(&lock);
	}
	return err;
}

int chat_contact_del(const char *name)
{
	char key[24]; /* "chat/ct/" and any int */
	int slot = -1;
	int err;

	if (!atomic_get(&ready)) {
		return -EBUSY;
	}
	k_mutex_lock(&lock, K_FOREVER);
	for (size_t i = 0; i < ARRAY_SIZE(contacts); i++) {
		if (contacts[i].used && strcmp(contacts[i].c.name, name) == 0) {
			slot = (int)i;
			break;
		}
	}
	k_mutex_unlock(&lock);
	if (slot < 0) {
		return -ENOENT;
	}
	snprintf(key, sizeof(key), "chat/ct/%d", slot);
	err = settings_delete(key);
	if (!err) {
		k_mutex_lock(&lock, K_FOREVER);
		contacts[slot].used = false;
		k_mutex_unlock(&lock);
	}
	return err;
}

int chat_contact_get(size_t i, struct chat_contact *out)
{
	int err = -ENOENT;

	if (!atomic_get(&ready)) {
		return -EBUSY;
	}
	k_mutex_lock(&lock, K_FOREVER);
	for (size_t j = 0; j < ARRAY_SIZE(contacts); j++) {
		if (contacts[j].used && i-- == 0) {
			*out = contacts[j].c;
			err = 0;
			break;
		}
	}
	k_mutex_unlock(&lock);
	return err;
}

int chat_heard_get(size_t i, struct chat_heard *out)
{
	int err = -ENOENT;

	k_mutex_lock(&lock, K_FOREVER);
	if (i < n_heard) {
		*out = heard[i];
		err = 0;
	}
	k_mutex_unlock(&lock);
	return err;
}

int chat_inbox_get(size_t i, struct chat_message *out)
{
	int err = -ENOENT;

	k_mutex_lock(&lock, K_FOREVER);
	if (i < inbox_count) {
		*out = inbox[(inbox_head + i) % ARRAY_SIZE(inbox)].m;
		err = 0;
	}
	k_mutex_unlock(&lock);
	return err;
}

int chat_inbox_read(uint32_t seq, size_t offset, struct chat_message *msg, char *title,
		    size_t title_cap, uint8_t *content, size_t content_cap)
{
	int err = -ENOENT;

	k_mutex_lock(&lock, K_FOREVER);
	for (size_t i = 0; i < inbox_count; i++) {
		size_t slot = (inbox_head + i) % ARRAY_SIZE(inbox);
		const struct chat_message *m = &inbox[slot].m;
		const uint8_t *p = &inbox_buf[inbox[slot].off];

		if (m->seq != seq) {
			continue;
		}
		*msg = *m;
		snprintf(title, title_cap, "%.*s", (int)MIN(m->title_len, title_cap - 1),
			 (const char *)p);
		size_t n = offset < m->stored_len ? MIN(m->stored_len - offset, content_cap) : 0;

		memcpy(content, p + m->title_len + offset, n);
		err = (int)n;
		break;
	}
	k_mutex_unlock(&lock);
	return err;
}

void chat_inbox_clear(void)
{
	k_mutex_lock(&lock, K_FOREVER);
	inbox_head = 0;
	inbox_count = 0;
	inbox_used = 0;
	memset(inbox_buf, 0, sizeof(inbox_buf)); /* the plaintext goes too */
	k_mutex_unlock(&lock);
}

int chat_announce(void)
{
	return client == NULL ? -ENOTCONN : ret_client_announce(client);
}

int chat_sync(void)
{
	if (!has_node) {
		return -ENOENT;
	}
	return client == NULL ? -ENOTCONN : ret_lxmf_sync(client, node, on_sync, NULL);
}

void chat_status(struct chat_status *out)
{
	memset(out, 0, sizeof(*out));
	out->state = (enum ret_client_state)atomic_get(&state);
	out->started = client != NULL;
	out->network = network_status();
	out->has_node = has_node;
	memcpy(out->node, node, sizeof(node));
	if (client != NULL) {
		(void)ret_client_dest_hash(client, out->addr);
	}
	k_mutex_lock(&lock, K_FOREVER);
	for (size_t i = 0; i < ARRAY_SIZE(contacts); i++) {
		out->contacts += contacts[i].used;
	}
	out->heard = n_heard;
	out->inbox = inbox_count;
	out->newest_seq = inbox_seq;
	k_mutex_unlock(&lock);
}
```

## src/chat.h
```c
/*
 * Copyright (c) 2026 Circuit Dojo LLC
 * SPDX-License-Identifier: LicenseRef-Reticulum
 *
 * The chat layer: contacts, the addresses heard announcing, the inbox and
 * sending, on top of ret_client. No shell in here: the shell commands
 * (chat_shell.c) are one front end, and buttons or a screen could be
 * another. Calls come from one front-end thread; the client callbacks it
 * installs run on the client thread and never wait on flash.
 */

#ifndef CHAT_H_
#define CHAT_H_

#include <stdbool.h>
#include <stddef.h>
#include <stdint.h>

#include <ret/ret_client.h>

#define CHAT_NAME_MAX 16 /* contact names, without the terminator */
#define CHAT_DISPLAY_MAX 32 /* announced display names kept */
#define CHAT_HEX_LEN  (2 * RET_DEST_HASH_LEN)

struct chat_contact {
	char name[CHAT_NAME_MAX + 1];
	uint8_t addr[RET_DEST_HASH_LEN];
};

struct chat_heard {
	uint8_t addr[RET_DEST_HASH_LEN];
	/* "" when it announced none; control characters replaced by '?' */
	char display[CHAT_DISPLAY_MAX + 1];
	uint8_t hops;
	int64_t uptime_ms; /* when last heard */
};

/** An inbox entry, without its text. */
struct chat_message {
	uint32_t seq; /* numbering starts at 1 each boot */
	uint8_t source[RET_DEST_HASH_LEN];
	double timestamp; /* the sender's clock */
	bool verified;
	uint16_t title_len; /* stored */
	uint32_t content_len; /* as received */
	uint32_t stored_len; /* content bytes kept (less when larger than the inbox) */
};

struct chat_status {
	enum ret_client_state state;
	bool started;
	const char *network;
	uint8_t addr[RET_DEST_HASH_LEN];
	bool has_node;
	uint8_t node[RET_DEST_HASH_LEN];
	size_t contacts;
	size_t heard;
	size_t inbox;
	uint32_t newest_seq;
};

/**
 * Load the contacts from settings. Before ret_client_start(); the client
 * then shares the settings backend.
 */
int chat_init(void);

/** The callbacks chat needs, filled into @p cfg (on_state, on_announce, on_lxmf). */
void chat_client_config(struct ret_client_config *cfg);

/** The client is started: commands that need it can run. */
void chat_set_client(struct ret_client *client);

/**
 * Resolve @p target: a contact name, a 32-hex address, or "#<n>" for the
 * n-th entry of the heard list (entries keep their place; a newcomer
 * replaces the one heard least recently when the list is full). @p label
 * (at least CHAT_HEX_LEN + 1 bytes) gets what to call it.
 *
 * Contact calls fail with -EBUSY until chat_init() has loaded them.
 *
 * @retval -ENOENT no such contact or heard entry
 * @retval -EINVAL not a name, address or index
 * @retval -EBUSY contacts not loaded yet
 */
int chat_resolve(const char *target, uint8_t addr[RET_DEST_HASH_LEN], char *label,
		 size_t label_cap);

/**
 * Send @p text to @p addr (from chat_resolve()) with ret_lxmf_send():
 * opportunistic when it fits one packet, otherwise DIRECT. Delivery is
 * logged later as "sent #<id> to <label>: ...".
 *
 * @param id    the outbox number the delivery log line will carry
 * @param heard false when @p addr has not announced since boot: the
 *              client requests its path first
 * @return 0, or the error from ret_lxmf_send() (-ENOTCONN before the
 *         client started)
 */
int chat_send(const uint8_t addr[RET_DEST_HASH_LEN], const char *text, size_t len, uint32_t *id,
	      bool *heard);

/** @retval -ENOSPC table full  -EEXIST name taken  -EINVAL bad name */
int chat_contact_add(const char *name, const uint8_t addr[RET_DEST_HASH_LEN]);
/** @retval -ENOENT no such contact */
int chat_contact_del(const char *name);
/** The @p i-th contact (0-based, in table order). @retval -ENOENT past the end */
int chat_contact_get(size_t i, struct chat_contact *out);

/** The @p i-th heard address (entry n+1 of chat_resolve()'s "#n"). @retval -ENOENT past the end */
int chat_heard_get(size_t i, struct chat_heard *out);

/** The @p i-th inbox message, oldest first. @retval -ENOENT past the end */
int chat_inbox_get(size_t i, struct chat_message *out);

/**
 * Message @p seq: its header, its title into @p title (NUL-terminated, cut
 * to fit), and stored content from byte @p offset into @p content (not
 * terminated), so a front end can show a long message in pieces.
 *
 * @return content bytes copied (0 past the end)
 * @retval -ENOENT no such message (never received, or evicted)
 */
int chat_inbox_read(uint32_t seq, size_t offset, struct chat_message *msg, char *title,
		    size_t title_cap, uint8_t *content, size_t content_cap);

void chat_inbox_clear(void);

/** Name to show for @p addr: its contact name, else its announced name, else hex. */
void chat_label(const uint8_t addr[RET_DEST_HASH_LEN], char *out, size_t cap);

/** @retval -ENOTCONN client not started */
int chat_announce(void);

/**
 * Collect from CONFIG_CHAT_PROPAGATION_NODE; the result is logged.
 *
 * @retval -ENOENT no node configured  -ENOTCONN client not started
 */
int chat_sync(void);

void chat_status(struct chat_status *out);

#endif /* CHAT_H_ */
```

## src/chat_shell.c
```c
/*
 * Copyright (c) 2026 Circuit Dojo LLC
 * SPDX-License-Identifier: LicenseRef-Reticulum
 *
 * Shell commands over chat.h. Each is a thin wrapper: parse, call, print.
 */

#include <errno.h>
#include <stdlib.h>
#include <string.h>
#include <time.h>

#include <zephyr/kernel.h>
#include <zephyr/shell/shell.h>
#include <zephyr/sys/util.h>

#include "chat.h"


static const char *state_str(enum ret_client_state s)
{
	switch (s) {
	case RET_STATE_CONNECTING:
		return "connecting";
	case RET_STATE_CONNECTED:
		return "connected";
	case RET_STATE_RECONNECTING:
		return "reconnecting";
	case RET_STATE_SUSPENDED:
		return "suspended";
	default:
		return "disconnected";
	}
}

static void ago(int64_t uptime_ms, char *out, size_t cap)
{
	int64_t s = (k_uptime_get() - uptime_ms) / MSEC_PER_SEC;

	if (s < 60) {
		snprintf(out, cap, "%llds", (long long)s);
	} else if (s < 3600) {
		snprintf(out, cap, "%lldm", (long long)(s / 60));
	} else {
		snprintf(out, cap, "%lldh", (long long)(s / 3600));
	}
}

/* Control characters from the network would drive the terminal: show them
 * as '?' (newlines and tabs stay in message text).
 */
static void sanitize(char *p, size_t n, bool keep_lines)
{
	for (size_t i = 0; i < n; i++) {
		uint8_t c = (uint8_t)p[i];

		if ((c < 0x20 && !(keep_lines && (c == '\n' || c == '\t'))) || c == 0x7f) {
			p[i] = '?';
		}
	}
}

static void print_send_error(const struct shell *sh, int err)
{
	switch (err) {
	case -EBUSY:
		shell_error(sh, "starting up: try again in a moment");
		break;
	case -ENOENT:
		shell_error(sh, "no such contact or heard entry (see 'contact list', 'heard')");
		break;
	case -EINVAL:
		shell_error(sh, "give a contact name, a 32-hex address or #<n> from 'heard'");
		break;
	case -ENOTCONN:
		shell_error(sh, "not started yet (see 'status')");
		break;
	case -ENODATA:
		shell_error(sh, "waiting for network time: LXMF needs the wall clock");
		break;
	case -EAGAIN:
		shell_error(sh, "send queue full: try again shortly");
		break;
	case -EMSGSIZE:
		shell_error(sh, "too long: at most %d bytes", RET_LXMF_DIRECT_MAX_CONTENT > 0
								       ? RET_LXMF_DIRECT_MAX_CONTENT
								       : RET_LXMF_OPPORTUNISTIC_MAX_CONTENT);
		break;
	default:
		shell_error(sh, "not sent: %d", err);
		break;
	}
}

/* msg send <to> <text...>: the text is the rest of the line, as typed. */
static int cmd_msg_send(const struct shell *sh, size_t argc, char **argv)
{
	uint8_t addr[RET_DEST_HASH_LEN];
	char who[CHAT_HEX_LEN + 1];
	uint32_t id;
	bool heard;
	int err;

	if (argc < 3 || argv[2][0] == '\0') {
		shell_error(sh, "usage: msg send <to> <text>");
		return -EINVAL;
	}
	/* Resolved once, and the line below says to whom it went. */
	err = chat_resolve(argv[1], addr, who, sizeof(who));
	if (!err) {
		err = chat_send(addr, argv[2], strlen(argv[2]), &id, &heard);
	}
	if (err) {
		print_send_error(sh, err);
		return err;
	}
	shell_print(sh, "queued #%u to %s (%u bytes)%s", id, who, (unsigned int)strlen(argv[2]),
		    heard ? "" : "; not heard yet: requesting its path");
	return 0;
}

static int cmd_msg_inbox(const struct shell *sh, size_t argc, char **argv)
{
	struct chat_message m;
	char who[CHAT_HEX_LEN + 1];

	ARG_UNUSED(argc);
	ARG_UNUSED(argv);
	if (chat_inbox_get(0, &m) != 0) {
		shell_print(sh, "inbox empty");
		return 0;
	}
	for (size_t i = 0; chat_inbox_get(i, &m) == 0; i++) {
		chat_label(m.source, who, sizeof(who));
		shell_print(sh, "#%u %s%s, %u bytes", m.seq, who, m.verified ? "" : " (unverified)",
			    m.content_len);
	}
	return 0;
}

static int cmd_msg_read(const struct shell *sh, size_t argc, char **argv)
{
	struct chat_message m;
	char who[CHAT_HEX_LEN + 1];
	char title[65];
	uint8_t part[128];
	char *end;
	unsigned long seq = strtoul(argv[1], &end, 10);
	size_t off = 0;
	int n;

	ARG_UNUSED(argc);
	n = *end == '\0' ? chat_inbox_read((uint32_t)seq, 0, &m, title, sizeof(title), part,
					   sizeof(part))
			 : -ENOENT;
	if (n < 0) {
		shell_error(sh, "no message #%s (see 'msg inbox')", argv[1]);
		return -ENOENT;
	}
	/* The sender's clock, in UTC (no float formatting needed). */
	time_t t = (time_t)m.timestamp;
	struct tm tm;
	char when[24] = "?";

	if (gmtime_r(&t, &tm) != NULL) {
		strftime(when, sizeof(when), "%Y-%m-%d %H:%M:%S", &tm);
	}
	chat_label(m.source, who, sizeof(who));
	shell_print(sh, "#%u from %s%s, sent %s UTC", m.seq, who,
		    m.verified ? "" : " (UNVERIFIED: sender's key unknown)", when);
	if (title[0]) {
		sanitize(title, strlen(title), false);
		shell_print(sh, "title: %s", title);
	}
	/* In pieces, so a long message needs no buffer of its own. A message
	 * evicted meanwhile just ends early.
	 */
	while (n > 0) {
		sanitize((char *)part, (size_t)n, true);
		shell_fprintf(sh, SHELL_NORMAL, "%.*s", n, (const char *)part);
		off += (size_t)n;
		n = chat_inbox_read((uint32_t)seq, off, &m, title, sizeof(title), part,
				    sizeof(part));
	}
	shell_print(sh, "");
	if (m.stored_len < m.content_len) {
		shell_print(sh, "[%u of %u bytes kept]", m.stored_len, m.content_len);
	}
	return 0;
}

static int cmd_msg_clear(const struct shell *sh, size_t argc, char **argv)
{
	ARG_UNUSED(argc);
	ARG_UNUSED(argv);
	chat_inbox_clear();
	shell_print(sh, "inbox cleared");
	return 0;
}

static int cmd_contact_add(const struct shell *sh, size_t argc, char **argv)
{
	uint8_t addr[RET_DEST_HASH_LEN];
	char label[CHAT_HEX_LEN + 1];
	int err;

	char hex[CHAT_HEX_LEN + 1];

	ARG_UNUSED(argc);
	err = chat_resolve(argv[2], addr, label, sizeof(label));
	if (err == -EBUSY) {
		print_send_error(sh, err);
		return err;
	} else if (err) {
		shell_error(sh, "give a 32-hex address or #<n> from 'heard'");
		return err;
	}
	err = chat_contact_add(argv[1], addr);
	switch (err) {
	case 0:
		/* The address saved, in full: "#n" is resolved once, here. */
		bin2hex(addr, sizeof(addr), hex, sizeof(hex));
		shell_print(sh, "added %s: %s", argv[1], hex);
		break;
	case -EBUSY:
		print_send_error(sh, err);
		break;
	case -EINVAL:
		shell_error(sh, "names are 1-%d of A-Z a-z 0-9 _ - .", CHAT_NAME_MAX);
		break;
	case -EEXIST:
		shell_error(sh, "%s exists", argv[1]);
		break;
	case -ENOSPC:
		shell_error(sh, "contacts full (%d)", CONFIG_CHAT_CONTACTS);
		break;
	default:
		shell_error(sh, "not saved: %d", err);
		break;
	}
	return err;
}

static int cmd_contact_del(const struct shell *sh, size_t argc, char **argv)
{
	int err = chat_contact_del(argv[1]);

	ARG_UNUSED(argc);
	if (err == -ENOENT) {
		shell_error(sh, "no contact %s", argv[1]);
	} else if (err == -EBUSY) {
		print_send_error(sh, err);
	} else if (err) {
		shell_error(sh, "not deleted: %d", err);
	} else {
		shell_print(sh, "deleted %s", argv[1]);
	}
	return err;
}

static int cmd_contact_list(const struct shell *sh, size_t argc, char **argv)
{
	struct chat_contact c;
	char addr[CHAT_HEX_LEN + 1];

	ARG_UNUSED(argc);
	ARG_UNUSED(argv);
	int err = chat_contact_get(0, &c);

	if (err == -EBUSY) {
		print_send_error(sh, err);
		return err;
	} else if (err) {
		shell_print(sh, "no contacts: 'contact add <name> <address|#n>'");
		return 0;
	}
	for (size_t i = 0; chat_contact_get(i, &c) == 0; i++) {
		bin2hex(c.addr, sizeof(c.addr), addr, sizeof(addr));
		shell_print(sh, "%-16s %s", c.name, addr);
	}
	return 0;
}

static int cmd_heard(const struct shell *sh, size_t argc, char **argv)
{
	struct chat_heard h;
	char addr[CHAT_HEX_LEN + 1];
	char when[24];

	ARG_UNUSED(argc);
	ARG_UNUSED(argv);
	if (chat_heard_get(0, &h) != 0) {
		shell_print(sh, "no LXMF announces heard since boot");
		return 0;
	}
	for (size_t i = 0; chat_heard_get(i, &h) == 0; i++) {
		bin2hex(h.addr, sizeof(h.addr), addr, sizeof(addr));
		ago(h.uptime_ms, when, sizeof(when));
		shell_print(sh, "#%u %s %s, %u hop%s, %s ago", (unsigned int)(i + 1), addr,
			    h.display[0] ? h.display : "(no name)", h.hops, h.hops == 1 ? "" : "s",
			    when);
	}
	return 0;
}

static int cmd_announce(const struct shell *sh, size_t argc, char **argv)
{
	int err = chat_announce();

	ARG_UNUSED(argc);
	ARG_UNUSED(argv);
	if (err == -ENOTCONN) {
		shell_error(sh, "not started yet");
	} else if (err) {
		shell_error(sh, "not queued: %d", err);
	} else {
		shell_print(sh, "announce queued");
	}
	return err;
}

static int cmd_sync(const struct shell *sh, size_t argc, char **argv)
{
	int err = chat_sync();

	ARG_UNUSED(argc);
	ARG_UNUSED(argv);
	if (err == -ENOENT) {
		shell_error(sh, "no propagation node: set CONFIG_CHAT_PROPAGATION_NODE");
	} else if (err == -ENOTCONN) {
		shell_error(sh, "not started yet");
	} else if (err) {
		shell_error(sh, "sync not started: %d", err);
	} else {
		shell_print(sh, "syncing");
	}
	return err;
}

static int cmd_status(const struct shell *sh, size_t argc, char **argv)
{
	struct chat_status s;
	char hex[CHAT_HEX_LEN + 1];

	ARG_UNUSED(argc);
	ARG_UNUSED(argv);
	chat_status(&s);
	shell_print(sh, "network:  %s", s.network);
	shell_print(sh, "client:   %s", s.started ? state_str(s.state) : "not started");
	if (s.started) {
		bin2hex(s.addr, sizeof(s.addr), hex, sizeof(hex));
		shell_print(sh, "address:  %s (%s)", hex, CONFIG_CHAT_DISPLAY_NAME);
	}
	if (s.has_node) {
		bin2hex(s.node, sizeof(s.node), hex, sizeof(hex));
		shell_print(sh, "node:     %s", hex);
	}
	shell_print(sh, "contacts: %u, heard: %u, inbox: %u", (unsigned int)s.contacts,
		    (unsigned int)s.heard, (unsigned int)s.inbox);
	return 0;
}

SHELL_STATIC_SUBCMD_SET_CREATE(msg_cmds,
	SHELL_CMD_ARG(send, NULL, "Send: msg send <contact|address|#n> <text>", cmd_msg_send, 2,
		      SHELL_OPT_ARG_RAW),
	SHELL_CMD(inbox, NULL, "List received messages", cmd_msg_inbox),
	SHELL_CMD_ARG(read, NULL, "Show one: msg read <n>", cmd_msg_read, 2, 0),
	SHELL_CMD(clear, NULL, "Empty the inbox", cmd_msg_clear),
	SHELL_SUBCMD_SET_END);
SHELL_CMD_REGISTER(msg, &msg_cmds, "LXMF messages", NULL);

SHELL_STATIC_SUBCMD_SET_CREATE(contact_cmds,
	SHELL_CMD_ARG(add, NULL, "contact add <name> <address|#n>", cmd_contact_add, 3, 0),
	SHELL_CMD_ARG(del, NULL, "contact del <name>", cmd_contact_del, 2, 0),
	SHELL_CMD(list, NULL, "List contacts", cmd_contact_list),
	SHELL_SUBCMD_SET_END);
SHELL_CMD_REGISTER(contact, &contact_cmds, "Names for LXMF addresses", NULL);

SHELL_CMD_REGISTER(heard, NULL, "LXMF addresses heard announcing since boot", cmd_heard);
SHELL_CMD_REGISTER(announce, NULL, "Announce our LXMF address now", cmd_announce);
SHELL_CMD_REGISTER(sync, NULL, "Collect messages from the propagation node", cmd_sync);
SHELL_CMD_REGISTER(status, NULL, "Connection, address and counts", cmd_status);
```

## src/network.h
```c
/*
 * Copyright (c) 2026 Circuit Dojo LLC
 * SPDX-License-Identifier: LicenseRef-Reticulum
 */

#ifndef NETWORK_H_
#define NETWORK_H_

/**
 * Block until the network is up and the wall clock is set (LTE and
 * network time on the modem; the host's clock on native_sim).
 */
void wait_for_network(void);

/** What wait_for_network() is waiting for, or "up". Any thread. */
const char *network_status(void);

#endif /* NETWORK_H_ */
```

## src/network_modem.c
```c
/*
 * Copyright (c) 2026 Circuit Dojo LLC
 * SPDX-License-Identifier: LicenseRef-Reticulum
 */

#include <date_time.h>
#include <zephyr/kernel.h>
#include <zephyr/logging/log.h>
#include <zephyr/net/conn_mgr_monitor.h>
#include <zephyr/net/net_event.h>
#include <zephyr/net/net_mgmt.h>

#include "network.h"

LOG_MODULE_REGISTER(network, LOG_LEVEL_INF);

static K_SEM_DEFINE(l4_up, 0, 1);
static K_SEM_DEFINE(time_known, 0, 1);
static struct net_mgmt_event_callback l4_cb;
static const char *volatile status = "starting";

const char *network_status(void)
{
	return status;
}

static void l4_handler(struct net_mgmt_event_callback *cb, uint64_t event,
		       struct net_if *iface)
{
	ARG_UNUSED(cb);
	ARG_UNUSED(iface);

	if (event == NET_EVENT_L4_CONNECTED) {
		LOG_INF("LTE connected");
		k_sem_give(&l4_up);
	} else if (event == NET_EVENT_L4_DISCONNECTED) {
		/* The client notices on its own and reconnects when LTE returns. */
		LOG_WRN("LTE disconnected");
	}
}

static void date_time_handler(const struct date_time_evt *evt)
{
	if (evt->type != DATE_TIME_NOT_OBTAINED) {
		k_sem_give(&time_known);
	}
}

void wait_for_network(void)
{
	net_mgmt_init_event_callback(&l4_cb, l4_handler,
				     NET_EVENT_L4_CONNECTED | NET_EVENT_L4_DISCONNECTED);
	net_mgmt_add_event_callback(&l4_cb);
	/* Replays the current state, in case LTE came up before we listened. */
	conn_mgr_mon_resend_status();

	status = "waiting for LTE";
	LOG_INF("waiting for LTE...");
	k_sem_take(&l4_up, K_FOREVER);

	/* LXMF timestamps are wall-clock time: wait until date_time has it. */
	date_time_register_handler(date_time_handler);
	if (!date_time_is_valid()) {
		status = "waiting for network time";
		LOG_INF("waiting for network time...");
		(void)date_time_update_async(date_time_handler);
		k_sem_take(&time_known, K_FOREVER);
	}
	LOG_INF("wall clock set");
	status = "up";
}
```

## src/network_sim.c
```c
/*
 * Copyright (c) 2026 Circuit Dojo LLC
 * SPDX-License-Identifier: LicenseRef-Reticulum
 */

#include <time.h>

#include <zephyr/logging/log.h>
#include <zephyr/sys/clock.h>

#include <native_rtc.h>

#include "network.h"

LOG_MODULE_REGISTER(network, LOG_LEVEL_INF);

static const char *volatile status = "starting";

const char *network_status(void)
{
	return status;
}

void wait_for_network(void)
{
	/* Host sockets (NSOS) are usable immediately. The wall clock, which
	 * LXMF timestamps need, comes from the host.
	 */
	uint64_t sec;
	uint32_t nsec;
	struct timespec ts;

	native_rtc_gettime(RTC_CLOCK_PSEUDOHOSTREALTIME, &nsec, &sec);
	ts.tv_sec = (time_t)sec;
	ts.tv_nsec = nsec;
	if (sys_clock_settime(SYS_CLOCK_REALTIME, &ts) != 0) {
		LOG_ERR("could not set the wall clock");
		return;
	}
	status = "up";
}
```
