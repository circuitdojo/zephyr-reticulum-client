## CMakeLists.txt
```
cmake_minimum_required(VERSION 3.20.0)

# Register ret-client as a module whether or not the active west manifest
# lists it. Zephyr keys modules by name, so this is harmless when west
# already provides it.
list(APPEND ZEPHYR_EXTRA_MODULES ${CMAKE_CURRENT_SOURCE_DIR}/../..)

find_package(Zephyr REQUIRED HINTS $ENV{ZEPHYR_BASE})
project(ret_basic)

target_sources(app PRIVATE src/main.c)

if(CONFIG_NRF_MODEM_LIB)
    target_sources(app PRIVATE src/network_modem.c)
else()
    target_sources(app PRIVATE src/network_sim.c)
endif()
```

## Kconfig
```
# Copyright (c) 2026 Circuit Dojo LLC
# SPDX-License-Identifier: LicenseRef-Reticulum

menu "ret_basic sample"

config RET_SAMPLE_DEST_NAME
	string "Destination name to send to"
	default "retclient.echo"
	help
	  Full "app.aspect..." name. The sample sends to the first
	  announced destination whose name hash matches.

config RET_SAMPLE_DEST_HASH
	string "Destination hash to send to (32 hex digits)"
	default ""
	help
	  When set, the sample sends to this destination straight away
	  instead of waiting for an announce matching RET_SAMPLE_DEST_NAME;
	  the client requests a path to it on demand.

config RET_SAMPLE_LOCAL_NAME
	string "The sample's own destination name"
	default "retclient.node"
	help
	  The sample announces this destination, logs what is sent to it,
	  and proves it. Its address comes from an identity created on
	  first start and kept in settings. Empty makes the sample
	  send-only.

config RET_SAMPLE_EXPECT_REPLIES
	bool "Require a reply to every message"
	help
	  For the end-to-end test against tools/rns_peer/peer.py --reply:
	  success also requires an "echo: ..." packet for every message
	  sent, waiting up to RET_SAMPLE_REPLY_WAIT_S for late ones.

config RET_SAMPLE_REPLY_WAIT_S
	int "Seconds to wait for outstanding replies"
	default 10
	depends on RET_SAMPLE_EXPECT_REPLIES

config RET_SAMPLE_LINK_TEST
	bool "Exercise a link before sending"
	help
	  Once the destination is known: open a link to it, identify (when
	  the sample has its own destination), request "/echo" with "ping",
	  check the response, request "/big" (a 4000-byte response, received
	  as a resource) and "/bigz" (compressed, which must be refused),
	  and close the link. Success then also
	  requires the link test to pass. For tools/rns_peer/peer.py.

config RET_SAMPLE_SEND_INTERVAL_S
	int "Seconds between messages"
	default 10

config RET_SAMPLE_MESSAGE_COUNT
	int "Messages to send (0 = forever)"
	default 0
	help
	  After this many messages resolve, the sample logs a summary and,
	  on native_sim, exits with status 0 if every message was
	  delivered and 1 otherwise.

endmenu

source "Kconfig.zephyr"
```

## prj.conf
```kconfig
CONFIG_MAIN_STACK_SIZE=4096
CONFIG_HEAP_MEM_POOL_SIZE=4096

CONFIG_NETWORKING=y
CONFIG_NET_SOCKETS=y
CONFIG_NET_IPV4=y
CONFIG_NET_TCP=y

CONFIG_RET_CLIENT=y
# No LXMF here: no DIRECT queue (8 KB).
CONFIG_RET_LXMF_DIRECT_POOL=0

# Settings keep the client's identity, and so its address, across reboots.
# Each board conf picks the backend (RET_CLIENT selects SETTINGS).

CONFIG_LOG=y
CONFIG_RET_LOG_LEVEL_INF=y
```

## boards/circuitdojo_feather_nrf9151_ns.conf
```kconfig
# nRF9151 Feather: TCP over the modem's offloaded sockets (like NSOS on
# native_sim, the client sees plain BSD sockets), PSA Crypto from TF-M.
CONFIG_NET_SOCKETS_OFFLOAD=y
CONFIG_NET_IPV6=y
CONFIG_NET_IPV6_NBR_CACHE=n
CONFIG_NET_IPV6_MLD=n

# The modem runs TCP/IP and DNS (sockets and getaddrinfo go to it). Zephyr's
# native stack stays only because the LTE net_if (NRF_MODEM_LIB_NET_IF)
# records the modem's addresses on the interface through it; everything
# else is trimmed (about 16 KB of RAM). Native TCP off: the TCP socket is
# the modem's. Native UDP stays: Zephyr's IP core does not build without
# one transport.
CONFIG_NET_TCP=n
CONFIG_NET_MAX_CONN=1
CONFIG_NET_MAX_CONTEXTS=1
CONFIG_NET_PKT_RX_COUNT=2
CONFIG_NET_PKT_TX_COUNT=2
CONFIG_NET_BUF_RX_COUNT=4
CONFIG_NET_BUF_TX_COUNT=4

# Modem: bring LTE up at boot; the connection manager reports L4 up/down.
CONFIG_NRF_MODEM_LIB=y
CONFIG_NRF_MODEM_LIB_NET_IF=y
CONFIG_NRF_MODEM_LIB_NET_IF_AUTO_START=y
CONFIG_NRF_MODEM_LIB_NET_IF_AUTO_CONNECT=y
CONFIG_NET_CONNECTION_MANAGER=y
CONFIG_NET_CONNECTION_MANAGER_MONITOR_STACK_SIZE=1024
CONFIG_AT_MONITOR_HEAP_SIZE=1024

# TF-M provides PSA Crypto to the non-secure app. NCS's minimal TF-M
# profile builds the secure image with random generation only and ignores
# PSA_WANT_* (SHA-256, HMAC and AES-CBC calls then fail with
# PSA_ERROR_NOT_SUPPORTED), so use the configurable profile.
CONFIG_TFM_PROFILE_TYPE_NOT_SET=y
# TF-M's 128 kB slot is in the flash layout:
# samples/common/circuitdojo_feather_nrf9151_ns_flash.dtsi.

# The board's startup code configures the nPM1300 PMIC through its MFD
# driver, so that stays; the charger and sensor drivers are not used.
CONFIG_NPM13XX_CHARGER=n
CONFIG_STS4X=n

# Settings in a file on LittleFS on the external W25Q128 NOR flash (the
# board's devicetree mounts it at /lfs), as in lion_sleep. Internal flash
# holds only firmware, so a re-layout or reflash cannot take the client's
# identity (its address) with it. At the mount root: the file backend
# creates the file but not parent directories.
CONFIG_SPI=y
CONFIG_SPI_NOR=y
CONFIG_SPI_NOR_FLASH_LAYOUT_PAGE_SIZE=4096
# Read the flash geometry from the chip's SFDP tables. nfed revisions
# before the jared/nor-flash-size fix declare the W25Q128 as 2 MiB (its
# devicetree `size` is in bits); with those, this is what makes the 16 MiB
# LittleFS work.
CONFIG_SPI_NOR_SFDP_RUNTIME=y
CONFIG_FLASH=y
CONFIG_FLASH_MAP=y
CONFIG_FLASH_PAGE_LAYOUT=y
CONFIG_FILE_SYSTEM=y
CONFIG_FILE_SYSTEM_LITTLEFS=y
CONFIG_SETTINGS_FILE=y
CONFIG_SETTINGS_FILE_PATH="/lfs/ret-settings"

# Stack use every 60 s. Measured on hardware: ret_client peaks at 2632 of
# its 6144 bytes (42 %) through decrypt, proof signing and announce checks.
CONFIG_THREAD_ANALYZER=y
CONFIG_THREAD_ANALYZER_AUTO=y
CONFIG_THREAD_ANALYZER_AUTO_INTERVAL=60
CONFIG_THREAD_NAME=y
# Immediate logging: deferred logging drops the first lines of the
# analyzer's burst (printk goes through the same buffer) and can lose a
# fault report before a reset.
CONFIG_LOG_MODE_IMMEDIATE=y
```

## boards/native_sim.conf
```kconfig
# Host BSD sockets (NSOS): reaches rnsd on 127.0.0.1 with no TAP
# interface or root. Like the nRF91 modem, sockets are offloaded, so the
# client exercises the same socket path it will on hardware.
CONFIG_NET_DRIVERS=y
CONFIG_NET_SOCKETS_OFFLOAD=y
CONFIG_NET_NATIVE_OFFLOADED_SOCKETS=y

# Embedded libc so eventfd is Zephyr's, not the host's (as in lion-client).
CONFIG_PICOLIBC=y

# PSA Crypto from Zephyr's mbedTLS (never NRF_SECURITY on native_sim).
CONFIG_MBEDTLS=y
CONFIG_MBEDTLS_BUILTIN=y
CONFIG_MBEDTLS_ENABLE_HEAP=y
CONFIG_MBEDTLS_HEAP_SIZE=8192

# Settings (prj.conf) live in the simulated flash, a file: select it with
# --flash=<path>.

CONFIG_RET_SERVER_HOST="127.0.0.1"
CONFIG_RET_SERVER_PORT=4242

# NSOS needs no Ethernet; keep the TAP driver from trying to create zeth.
CONFIG_ETH_NATIVE_TAP=n
```

## src/main.c
```c
/*
 * Copyright (c) 2026 Circuit Dojo LLC
 * SPDX-License-Identifier: LicenseRef-Reticulum
 *
 * Waits for an announce from CONFIG_RET_SAMPLE_DEST_NAME, then sends it
 * an encrypted message every CONFIG_RET_SAMPLE_SEND_INTERVAL_S seconds
 * and reports each delivery proof.
 */

#include <stdio.h>
#include <string.h>

#include <zephyr/kernel.h>
#include <zephyr/logging/log.h>
#include <zephyr/sys/util.h>

#include <mpack.h>
#include <ret/ret_client.h>

#include "network.h"

#if defined(CONFIG_ARCH_POSIX)
#include <nsi_main.h>
#endif

LOG_MODULE_REGISTER(ret_basic, LOG_LEVEL_INF);

static uint8_t target_name_hash[10];
static uint8_t target_dest[RET_DEST_HASH_LEN];
static atomic_t target_known;
static K_SEM_DEFINE(target_sem, 0, 1);

static atomic_t delivered;
static atomic_t replies;
static K_SEM_DEFINE(reply_sem, 0, K_SEM_MAX_LIMIT);
static atomic_t resolved;
static K_SEM_DEFINE(resolved_sem, 0, K_SEM_MAX_LIMIT);

static void hex(const uint8_t *b, size_t n, char *out)
{
	for (size_t i = 0; i < n; i++) {
		sprintf(&out[2 * i], "%02x", b[i]);
	}
}

static void on_announce(const struct ret_announce_info *info, void *user)
{
	char h[2 * RET_DEST_HASH_LEN + 1];

	ARG_UNUSED(user);
	hex(info->dest_hash, RET_DEST_HASH_LEN, h);

	if (memcmp(info->name_hash, target_name_hash, sizeof(target_name_hash)) != 0) {
		LOG_INF("announce valid (other destination) %s hops %u", h, info->hops);
		return;
	}

	LOG_INF("ANNOUNCE VALID %s %s hops %u%s", CONFIG_RET_SAMPLE_DEST_NAME, h, info->hops,
		info->has_ratchet ? " ratchet" : "");

	if (!atomic_get(&target_known)) {
		memcpy(target_dest, info->dest_hash, RET_DEST_HASH_LEN);
		atomic_set(&target_known, 1);
		k_sem_give(&target_sem);
	}
}

static void on_data(const uint8_t *data, size_t len, void *user)
{
	static const char prefix[] = "echo: ";

	ARG_UNUSED(user);
	char text[RET_MAX_PAYLOAD + 1];

	/* A terminated copy: deferred logging copies %s up to the terminator,
	 * whatever the precision.
	 */
	snprintf(text, sizeof(text), "%.*s", (int)MIN(len, RET_MAX_PAYLOAD), (const char *)data);
	LOG_INF("RECEIVED %s", text);
	if (len >= sizeof(prefix) - 1 && memcmp(data, prefix, sizeof(prefix) - 1) == 0) {
		atomic_inc(&replies);
		k_sem_give(&reply_sem);
	}
}

static void on_receipt(const uint8_t packet_hash[RET_PACKET_HASH_LEN],
		       enum ret_receipt_status status, uint32_t rtt_ms, void *user)
{
	char h[2 * 8 + 1];
	int n = (int)(intptr_t)user;

	hex(packet_hash, 8, h);

	switch (status) {
	case RET_RECEIPT_DELIVERED:
		atomic_inc(&delivered);
		LOG_INF("PROOF VALID #%d rtt=%u ms packet %s..", n, rtt_ms, h);
		break;
	case RET_RECEIPT_TIMEOUT:
		LOG_WRN("PROOF TIMEOUT #%d packet %s..", n, h);
		break;
	case RET_RECEIPT_DISCONNECTED:
		LOG_WRN("DISCONNECTED before proof #%d", n);
		break;
	default:
		LOG_ERR("SEND FAILED #%d", n);
		break;
	}
	atomic_inc(&resolved);
	k_sem_give(&resolved_sem);
}

#if defined(CONFIG_RET_SAMPLE_LINK_TEST)
static K_SEM_DEFINE(link_sem, 0, 1);
static atomic_t link_event = ATOMIC_INIT(-1);
static K_SEM_DEFINE(response_sem, 0, 1);
static char response_text[96];
static int response_status;
static bool link_ok;

static void on_link(enum ret_link_event ev, int reason, void *user)
{
	ARG_UNUSED(user);
	LOG_INF("LINK EVENT %d (%d)", ev, reason);
	atomic_set(&link_event, ev);
	k_sem_give(&link_sem);
}

static void on_response(int status, const uint8_t *resp, size_t len, void *user)
{
	mpack_reader_t r;

	ARG_UNUSED(user);
	response_status = status;
	response_text[0] = '\0';
	if (status == 0) {
		mpack_reader_init_data(&r, (const char *)resp, len);
		uint32_t n = mpack_expect_bin_max(&r, sizeof(response_text) - 1);

		mpack_read_bytes(&r, response_text, n);
		mpack_done_bin(&r);
		response_status = mpack_reader_destroy(&r) == mpack_ok ? 0 : -EBADMSG;
		response_text[response_status == 0 ? n : 0] = '\0';
	}
	k_sem_give(&response_sem);
}

/* "/big": a response larger than a packet arrives as a resource. */
#define BIG_SIZE 4000

static void on_big_response(int status, const uint8_t *resp, size_t len, void *user)
{
	mpack_reader_t r;

	ARG_UNUSED(user);
	response_status = status;
	if (status == 0) {
		mpack_reader_init_data(&r, (const char *)resp, len);
		uint32_t n = mpack_expect_bin(&r);
		const char *data = mpack_read_bytes_inplace(&r, n);

		mpack_done_bin(&r);
		response_status = mpack_reader_destroy(&r) == mpack_ok && n == BIG_SIZE ? 0 : -EBADMSG;
		for (uint32_t i = 0; response_status == 0 && i < n; i++) {
			if ((uint8_t)data[i] != (uint8_t)(i * 7 + 3)) {
				response_status = -EBADMSG;
			}
		}
	}
	k_sem_give(&response_sem);
}

static int big_request(struct ret_client *client, const char *path)
{
	/* msgpack uint16 BIG_SIZE */
	static const uint8_t size[] = { 0xcd, BIG_SIZE >> 8, BIG_SIZE & 0xFF };

	if (ret_client_link_request(client, path, size, sizeof(size), on_big_response, NULL) != 0 ||
	    k_sem_take(&response_sem, K_SECONDS(60)) != 0) {
		return -ETIMEDOUT;
	}
	return response_status;
}

static bool wait_link_event(enum ret_link_event want)
{
	if (k_sem_take(&link_sem, K_SECONDS(30)) != 0) {
		return false;
	}
	return atomic_get(&link_event) == want;
}

/* Open, identify, request "/echo", close: logs LINK ACTIVE, LINK RESPONSE
 * <text> and LINK CLOSED for the e2e script.
 */
static void link_test(struct ret_client *client)
{
	static const uint8_t ping[] = { 0xc4, 0x04, 'p', 'i', 'n', 'g' };

	if (ret_client_link_open(client, target_dest, on_link, NULL) != 0 ||
	    !wait_link_event(RET_LINK_EVT_ACTIVE)) {
		LOG_ERR("LINK FAILED to open");
		return;
	}
	LOG_INF("LINK ACTIVE");
	(void)ret_client_link_identify(client);
	if (ret_client_link_request(client, "/echo", ping, sizeof(ping), on_response, NULL) != 0 ||
	    k_sem_take(&response_sem, K_SECONDS(30)) != 0 || response_status != 0) {
		LOG_ERR("LINK FAILED request (%d)", response_status);
		return;
	}
	LOG_INF("LINK RESPONSE %s", response_text);

	int err = big_request(client, "/big");

	if (err) {
		LOG_ERR("LINK FAILED big response (%d)", err);
		return;
	}
	LOG_INF("LINK BIG RESPONSE %d bytes", BIG_SIZE);

	/* bz2 is out of reach on the MCU: a compressed resource is refused. */
	err = big_request(client, "/bigz");
	if (err != -ENOTSUP) {
		LOG_ERR("LINK FAILED compressed response not refused (%d)", err);
		return;
	}
	LOG_INF("LINK COMPRESSED REFUSED");

	/* Idle past the responder's stale time (2 x the 5 s minimum
	 * keepalive): only the client's keepalives keep the link up.
	 */
	k_sleep(K_SECONDS(15));
	if (ret_client_link_request(client, "/echo", ping, sizeof(ping), on_response, NULL) != 0 ||
	    k_sem_take(&response_sem, K_SECONDS(30)) != 0 || response_status != 0) {
		LOG_ERR("LINK FAILED after idle (%d)", response_status);
		return;
	}
	LOG_INF("LINK RESPONSE AFTER IDLE %s", response_text);

	if (ret_client_link_close(client) != 0 || !wait_link_event(RET_LINK_EVT_CLOSED)) {
		LOG_ERR("LINK FAILED to close");
		return;
	}
	LOG_INF("LINK CLOSED");
	link_ok = strncmp(response_text, "pong:ping:", 10) == 0;
}
#endif

static void finish(int sent)
{
	int ok = (int)atomic_get(&delivered);
	bool success = ok == sent;

#if defined(CONFIG_RET_SAMPLE_LINK_TEST)
	success = success && link_ok;
#endif

#if defined(CONFIG_RET_SAMPLE_EXPECT_REPLIES)
	int64_t until = k_uptime_get() + CONFIG_RET_SAMPLE_REPLY_WAIT_S * MSEC_PER_SEC;

	while (atomic_get(&replies) < sent && k_uptime_get() < until) {
		k_sem_take(&reply_sem, K_MSEC(until - k_uptime_get()));
	}
	success = success && atomic_get(&replies) == sent;
	LOG_INF("DONE %d/%d delivered, %d/%d replies", ok, sent, (int)atomic_get(&replies), sent);
#else
	LOG_INF("DONE %d/%d delivered", ok, sent);
#endif
#if defined(CONFIG_ARCH_POSIX)
	k_sleep(K_MSEC(100)); /* let the log thread flush */
	nsi_exit(success ? 0 : 1);
#else
	ARG_UNUSED(success);
#endif
}

int main(void)
{
	static struct ret_client_config cfg = {
		.on_announce = on_announce,
		.on_data = on_data,
	};
	struct ret_client *client;
	char msg[32];
	int err;

	if (strlen(CONFIG_RET_SAMPLE_LOCAL_NAME) > 0) {
		cfg.dest_name = CONFIG_RET_SAMPLE_LOCAL_NAME;
	}
	client = ret_client_create(&cfg);

	wait_for_network();

	/* Before start: an announce may arrive as soon as the thread runs. */
	err = ret_client_name_hash(CONFIG_RET_SAMPLE_DEST_NAME, target_name_hash);
	if (err) {
		LOG_ERR("name hash failed: %d", err);
		return err;
	}

	err = ret_client_start(client);
	if (err) {
		LOG_ERR("ret_client_start failed: %d", err);
		return err;
	}

	uint8_t own[RET_DEST_HASH_LEN];
	char own_hex[2 * RET_DEST_HASH_LEN + 1];

	if (ret_client_dest_hash(client, own) == 0) {
		hex(own, sizeof(own), own_hex);
		LOG_INF("OWN ADDRESS %s %s", CONFIG_RET_SAMPLE_LOCAL_NAME, own_hex);
	}

	if (strlen(CONFIG_RET_SAMPLE_DEST_HASH) > 0) {
		if (hex2bin(CONFIG_RET_SAMPLE_DEST_HASH, strlen(CONFIG_RET_SAMPLE_DEST_HASH),
			    target_dest, sizeof(target_dest)) != sizeof(target_dest)) {
			LOG_ERR("RET_SAMPLE_DEST_HASH must be 32 hex digits");
			return -EINVAL;
		}
		atomic_set(&target_known, 1);
		LOG_INF("sending to %s (path requested on demand)", CONFIG_RET_SAMPLE_DEST_HASH);
	} else {
		LOG_INF("waiting for announce from %s", CONFIG_RET_SAMPLE_DEST_NAME);
		k_sem_take(&target_sem, K_FOREVER);
	}

#if defined(CONFIG_RET_SAMPLE_LINK_TEST)
	link_test(client);
#endif

	for (int n = 1; CONFIG_RET_SAMPLE_MESSAGE_COUNT == 0 || n <= CONFIG_RET_SAMPLE_MESSAGE_COUNT;
	     n++) {
		int len = snprintf(msg, sizeof(msg), "hello #%d", n);

		err = ret_client_send(client, target_dest, (const uint8_t *)msg, len, on_receipt,
				      (void *)(intptr_t)n);
		if (err) {
			LOG_ERR("send #%d not queued: %d", n, err);
			atomic_inc(&resolved);
		} else {
			LOG_INF("SENT %s", msg);
		}
		k_sleep(K_SECONDS(CONFIG_RET_SAMPLE_SEND_INTERVAL_S));
	}

	/* Wait for the remaining receipts to resolve (proof or timeout). */
	while (atomic_get(&resolved) < CONFIG_RET_SAMPLE_MESSAGE_COUNT) {
		k_sem_take(&resolved_sem, K_FOREVER);
	}
	finish(CONFIG_RET_SAMPLE_MESSAGE_COUNT);
	return 0;
}
```

## src/network_modem.c
```c
/*
 * Copyright (c) 2026 Circuit Dojo LLC
 * SPDX-License-Identifier: Apache-2.0
 */

#include <zephyr/kernel.h>
#include <zephyr/logging/log.h>
#include <zephyr/net/conn_mgr_monitor.h>
#include <zephyr/net/net_event.h>
#include <zephyr/net/net_mgmt.h>

#include "network.h"

LOG_MODULE_REGISTER(network, LOG_LEVEL_INF);

static K_SEM_DEFINE(l4_up, 0, 1);
static struct net_mgmt_event_callback l4_cb;

static void l4_handler(struct net_mgmt_event_callback *cb, uint64_t event,
		       struct net_if *iface)
{
	ARG_UNUSED(cb);
	ARG_UNUSED(iface);

	if (event == NET_EVENT_L4_CONNECTED) {
		LOG_INF("LTE connected");
		k_sem_give(&l4_up);
	} else if (event == NET_EVENT_L4_DISCONNECTED) {
		/* The client notices on its own and reconnects when LTE returns. */
		LOG_WRN("LTE disconnected");
	}
}

void wait_for_network(void)
{
	net_mgmt_init_event_callback(&l4_cb, l4_handler,
				     NET_EVENT_L4_CONNECTED | NET_EVENT_L4_DISCONNECTED);
	net_mgmt_add_event_callback(&l4_cb);
	/* Replays the current state, in case LTE came up before we listened. */
	conn_mgr_mon_resend_status();

	LOG_INF("waiting for LTE...");
	k_sem_take(&l4_up, K_FOREVER);
}
```

## src/network_sim.c
```c
/*
 * Copyright (c) 2026 Circuit Dojo LLC
 * SPDX-License-Identifier: LicenseRef-Reticulum
 */

#include "network.h"

void wait_for_network(void)
{
	/* Host sockets (NSOS) are usable immediately. */
}
```
