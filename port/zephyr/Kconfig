## port/zephyr/Kconfig
```kconfig
# Copyright (c) 2026 Circuit Dojo LLC
# SPDX-License-Identifier: Apache-2.0

config RET_CORE
	bool "Reticulum protocol core"
	# The PSA Crypto API (Zephyr 4.4+, so NCS 3.5+ too): its provider is
	# TF-M on the nRF91 (BUILD_WITH_TFM), Mbed TLS / TF-PSA-Crypto on
	# native_sim (PSA_CRYPTO_PROVIDER choice).
	select PSA_CRYPTO
	imply PSA_WANT_ALG_SHA_256
	imply PSA_WANT_ALG_HMAC
	imply PSA_WANT_KEY_TYPE_HMAC
	imply PSA_WANT_KEY_TYPE_AES
	imply PSA_WANT_ALG_CBC_NO_PADDING
	select ENTROPY_GENERATOR
	help
	  Reticulum wire protocol without networking: HDLC framing, packet
	  codec, identity/destination hashing, announce validation,
	  encryption to SINGLE destinations and proof validation. Curve
	  operations come from Monocypher; hashing, HMAC and AES come from
	  the PSA Crypto API. Selected by RET_CLIENT; unit tests enable it
	  on its own.

menuconfig RET_CLIENT
	bool "Reticulum client"
	select RET_CORE
	select NET_SOCKETS
	select EVENTFD
	# The client identity (its address) and announce clock persist here;
	# the application picks the backend (e.g. SETTINGS_NVS).
	select SETTINGS
	help
	  Reticulum client that connects to an rnsd TCPServerInterface,
	  learns destinations from announces, sends encrypted DATA packets
	  and validates delivery proofs.

if RET_CORE

config RET_MAX_KNOWN_DESTINATIONS
	int "Known destinations table size"
	default 8
	help
	  Destinations learned from validated announces. The least
	  recently seen entry is evicted when the table is full.

config RET_MAX_PENDING_RECEIPTS
	int "Pending delivery receipts"
	default 8

config RET_RECEIPT_TIMEOUT_MS
	int "Delivery proof timeout (ms)"
	default 30000

config RET_RESOURCE_MAX_SIZE
	int "Largest resource accepted (bytes of encrypted stream)"
	default 8192
	range 1024 1048576
	help
	  Responses larger than one link packet, and LXMF DIRECT messages
	  larger than one (on inbound links), arrive as RNS Resources and are
	  assembled in RAM: the client holds a stream buffer and a plaintext
	  buffer of this size, and receives one Resource at a time. A DIRECT
	  message can be up to about this size minus 69 bytes; larger
	  resources are refused.

menuconfig RET_TRANSPORT
	bool "Transport node"
	help
	  Route between interfaces as an RNS instance with enable_transport
	  does (src/ret_transport.c): forward packets along known paths,
	  rebroadcast announces (also on the interface they arrived on),
	  answer and forward path requests, relay links and proofs. Paths
	  and their announces live in a store the application provides
	  (flash on a device); RAM holds the tables below.

if RET_TRANSPORT

config RET_TRANSPORT_MAX_IFACES
	int "Interfaces"
	default 2
	range 1 8

config RET_TRANSPORT_PATHS
	int "Paths cached in RAM"
	default 64
	help
	  The store holds every path; a lookup that misses RAM reads it from
	  the store and replaces the least recently used entry.

config RET_TRANSPORT_RANDOM_BLOBS
	int "Announce random blobs kept per path"
	default 8
	range 1 64
	help
	  RNS keeps 64 to recognise replayed announces; the newest emission
	  time also guards against replays, so a few suffice.

config RET_TRANSPORT_ANNOUNCES
	int "Announces waiting for rebroadcast"
	default 16

config RET_TRANSPORT_ANNOUNCE_QUEUE
	int "Announces queued per interface by the announce cap"
	default 32

config RET_TRANSPORT_HELD_ANNOUNCES
	int "Announces held per interface by ingress control"
	default 4

config RET_TRANSPORT_LINKS
	int "Links relayed"
	default 16

config RET_TRANSPORT_REVERSE
	int "Packets awaiting a proof (reverse table)"
	default 32

config RET_TRANSPORT_HASHLIST
	int "Packet hashes remembered, per half"
	default 256
	help
	  Two halves, rotated when the current one fills, as RNS's
	  packet_hashlist and packet_hashlist_prev. 16 bytes each.

config RET_TRANSPORT_PR_TAGS
	int "Path request tags remembered, per half"
	default 64

config RET_TRANSPORT_PATH_REQUESTS
	int "Path requests tracked (own, in flight, being discovered)"
	default 8

endif # RET_TRANSPORT

module = RET
module-str = Reticulum
source "subsys/logging/Kconfig.template.log_config"

endif # RET_CORE

if RET_CLIENT

configdefault ZVFS_EVENTFD_MAX
	int
	default 3

config RET_SERVER_HOST
	string "rnsd host"
	default "127.0.0.1"
	help
	  Host (IP literal or hostname) of the rnsd TCPServerInterface.

config RET_SERVER_PORT
	int "rnsd TCP port"
	default 4242

config RET_IFAC
	bool "Interface access codes (protected interfaces)"
	help
	  Join an rnsd interface configured with network_name and/or
	  passphrase: every packet is signed with a key derived from them,
	  and packets without a valid code are dropped, both ways (RNS's
	  IFAC). With it on, a network name or passphrase must be set:
	  ret_client_start() fails otherwise. Costs one Ed25519 signature
	  per packet sent and received (every send path, and so the client
	  thread's deepest stack use, grows by a signature: check
	  RET_THREAD_STACK_SIZE with the thread analyzer), and about 800
	  bytes of RAM.

if RET_IFAC

config RET_IFAC_NETWORK_NAME
	string "IFAC network name (rnsd's network_name)"
	default ""
	help
	  Used when ret_client_config.ifac_network_name is NULL. Empty: not
	  part of the key. At least one of the name and passphrase must be
	  set, matching the interface's.

config RET_IFAC_PASSPHRASE
	string "IFAC passphrase (rnsd's passphrase)"
	default ""
	help
	  Used when ret_client_config.ifac_passphrase is NULL. It is built
	  into the firmware image: keep it in a gitignored env/ overlay.

config RET_IFAC_SIZE
	int "IFAC size in bytes (rnsd's ifac_size / 8)"
	default 16
	range 1 64
	help
	  Must match the interface. RNS's TCP interfaces default to 16
	  bytes (ifac_size = 128).

endif # RET_IFAC

config RET_THREAD_STACK_SIZE
	int "Client thread stack size"
	default 6144

config RET_THREAD_PRIORITY
	int "Client thread priority"
	default 7

config RET_TX_QUEUE_DEPTH
	int "Outbound send queue depth"
	default 4

config RET_MAX_HELD_SENDS
	int "Sends held while a path is requested"
	default 4
	help
	  A send to a destination with no current path (never announced
	  to us, or learned on a previous connection) is held while a path
	  request goes out, and released by the announce or path response.

config RET_PATH_REQUEST_INTERVAL_MS
	int "Path request retry interval (ms)"
	default 15000
	help
	  While a send is held, its path request is repeated this often.
	  rnsd batches repeat requests for the same destination for 45 s
	  (Transport.PATH_REQUEST_GATE_TIMEOUT) unless one was answered, so
	  faster retries only add traffic.

config RET_PATH_REQUEST_TIMEOUT_MS
	int "Path request timeout (ms)"
	default 60000
	help
	  A held send fails with RET_RECEIPT_FAILED if no path arrives in
	  this time. Keep it above rnsd's 45 s path request gate plus one
	  retry interval, or a request made soon after an earlier one for
	  the same destination can never be answered in time.

config RET_CONNECT_TIMEOUT_MS
	int "TCP connect timeout per address (ms)"
	default 30000
	help
	  The connect runs non-blocking, so the client keeps answering
	  queued sends and expiring held ones while it waits.

config RET_SEND_TIMEOUT_MS
	int "Socket send timeout (ms)"
	default 10000
	help
	  SO_SNDTIMEO on the TCP socket, so a stalled connection cannot
	  block the client thread indefinitely. A send that times out
	  drops the connection.

config RET_TCP_KEEPALIVE
	bool "TCP keepalive"
	default y
	depends on NET_NATIVE_OFFLOADED_SOCKETS || NET_TCP_KEEPALIVE
	help
	  Enable TCP keepalive probes so a connection silently dropped by a
	  NAT is detected. Only offered where the socket layer implements
	  them (host sockets on native_sim, Zephyr's TCP stack with
	  NET_TCP_KEEPALIVE). The nRF91 modem does not; there the receipt
	  watchdog below detects a dead connection.

if RET_TCP_KEEPALIVE

config RET_TCP_KEEPALIVE_IDLE_S
	int "Idle time before the first probe (s)"
	default 60

config RET_TCP_KEEPALIVE_INTERVAL_S
	int "Interval between probes (s)"
	default 10

config RET_TCP_KEEPALIVE_COUNT
	int "Unanswered probes before the connection is dropped"
	default 3

endif # RET_TCP_KEEPALIVE

config RET_RECONNECT_AFTER_TIMEOUTS
	int "Reconnect after this many consecutive receipt timeouts"
	default 3
	help
	  Consecutive sends that time out without a proof suggest the
	  connection is dead even though the socket looks open. Only sends
	  to destinations that have proved before count: RNS destinations
	  do not prove by default, and their silence says nothing about the
	  link. A delivered proof resets the count. 0 disables.

config RET_RX_SILENCE_TIMEOUT_S
	int "Reconnect after this long without receiving anything (s)"
	default 0
	help
	  Off by default: a quiet network may legitimately send nothing for
	  a long time. Useful where the upstream is known to announce
	  regularly. 0 disables.

config RET_ANNOUNCE_INTERVAL_S
	int "Re-announce the client's destination every N seconds"
	default 0
	help
	  The client's own destination (when the application registers
	  one) is announced on every connect and on ret_client_announce().
	  A non-zero value also re-announces it periodically. Each announce
	  persists the announce clock, so keep this modest on flash.

config RET_ANNOUNCE_CLOCK_BLOCK
	int "Announce clock values reserved per flash write"
	default 64
	range 1 65536
	help
	  Each announce needs an emission time newer than any used before,
	  across reboots. The client persists a reservation and uses values
	  from it in RAM, writing flash once per this many announces. A
	  reboot skips the rest of the block, which costs nothing (the
	  clock has 40 bits).

config RET_RATCHETS
	bool "Ratchets for the client's own destination"
	default y
	help
	  Announce a ratchet (an X25519 key rotated over time) with the
	  client's destination, as Destination.enable_ratchets() does.
	  Senders that heard it encrypt to the ratchet instead of the
	  identity key, so a key that has been rotated out and erased can
	  no longer decrypt captured traffic (forward secrecy). Costs 32
	  bytes per announce and one settings write per rotation. Turning
	  it off leaves stored ratchets in place.

if RET_RATCHETS

config RET_RATCHET_COUNT
	int "Ratchets kept"
	default 8
	range 1 32
	help
	  Ratchets kept to decrypt with, newest first (RNS keeps 512; each
	  one here costs RAM, and X25519 time on every message to the
	  identity key). Senders keep using
	  the last ratchet they heard (RNS remembers one for 30 days), and
	  a propagation node holds messages until they are synced, so
	  count x RET_RATCHET_INTERVAL_S is how old a message to the
	  client may be and still decrypt. Each one is a 44-byte settings
	  record, and every message to the identity key (from a sender
	  without our ratchet) costs one X25519 per ratchet before it
	  decrypts.

config RET_RATCHET_INTERVAL_S
	int "Minimum time between ratchet rotations (s)"
	default 86400
	range 10 31536000
	help
	  An announce rotates to a new ratchet when the newest is older
	  than this. Rotation needs the realtime clock (set by the
	  application, e.g. from network time); without it the current
	  ratchet keeps being announced. RNS's default is 1800 s; a day
	  suits flash and the RET_RATCHET_COUNT window better. Values
	  under a few minutes are for tests. If a new ratchet cannot be
	  stored, the announce carries the current one and the next
	  announce tries again.

endif # RET_RATCHETS

config RET_PATH_RESPONSE_INTERVAL_MS
	int "Minimum time between path responses for our destination (ms)"
	default 5000
	help
	  Answering a path request means signing and sending an announce.
	  Requests arriving faster than this, or repeating a recent tag, are
	  ignored, so the network cannot make the client announce at will.

config RET_RECENT_PACKETS
	int "Recently received packets remembered for duplicate filtering"
	default 8
	help
	  A DATA packet whose hash was seen recently is dropped instead of
	  being delivered and proved again.

config RET_LINK_MAX_REQUESTS
	int "Requests outstanding on the link at once"
	default 2

config RET_RECONNECT_BACKOFF_MAX_S
	int "Maximum reconnect backoff (s)"
	default 60
	help
	  Reconnect delay doubles from 1 s after each failed attempt, up
	  to this limit.

config RET_INBOUND_LINKS
	int "Links other nodes may open to the client's destination at once"
	default 2
	range 0 8
	help
	  Needs a destination (dest_name, or on_lxmf). LXMF senders deliver
	  DIRECT messages over such a link: one packet, or a Resource when
	  larger than 431 bytes (bounded by RET_RESOURCE_MAX_SIZE; one
	  Resource arrives at a time). Data on an inbound link goes to
	  on_lxmf, or on_data without LXMF. About 150 bytes of RAM each.
	  When full, a link that has waited over 10 s in handshake is
	  replaced; otherwise the request is dropped. Repeated (replayed)
	  link requests are ignored. 0 drops every link request.

config RET_LXMF_DIRECT_QUEUE
	int "LXMF messages queued for DIRECT delivery"
	default 4
	range 1 16
	help
	  Messages ret_lxmf_send() hands to DIRECT delivery (larger than
	  one opportunistic packet, or asked for) wait here, packed, until
	  the client thread has delivered them one at a time.

config RET_LXMF_DIRECT_POOL
	int "Bytes for LXMF messages queued for DIRECT delivery"
	default RET_RESOURCE_MAX_SIZE
	range 0 1048576
	help
	  The packed messages in the DIRECT queue (title and content plus
	  about 120 bytes each). A message larger than one link packet goes
	  as a Resource, so RET_RESOURCE_MAX_SIZE also bounds it; the default
	  holds one message of the largest size. It must hold more than one
	  opportunistic message (about 405 bytes); 0 turns DIRECT sending off,
	  for an application that sends no LXMF: ret_lxmf_send() then refuses
	  messages over one packet (-EMSGSIZE) and RET_LXMF_METHOD_DIRECT
	  (-ENOTSUP).

config RET_LXMF_DIRECT_ATTEMPTS
	int "Delivery attempts per DIRECT LXMF message"
	default 3
	range 1 10
	help
	  Each attempt opens a new link to the recipient; a failed one is
	  retried 10 s later, as LXMRouter does (it tries 5 times). A message
	  the recipient refused is not retried.

config RET_LXMF_SEEN_ENTRIES
	int "LXMF messages remembered against repeats and replays"
	default 64
	range 4 1024
	help
	  Received messages are remembered (hash and timestamp: 24 bytes
	  each in settings, 32 in RAM) so a repeat or a replayed packet is
	  not delivered twice, across reboots too. When the table fills
	  with messages younger than RET_LXMF_MAX_AGE_DAYS, the oldest is
	  forgotten and messages as old as it are refused from then on.
	  Only verified messages evict; see src/ret_lxmf_seen.h.

config RET_LXMF_KNOWN_SENDERS
	int "LXMF senders whose keys are kept across reboots"
	default 16
	range 1 256
	help
	  A sender's key normally comes from its announce, which a device
	  that was asleep or rebooted has not heard: its messages would
	  arrive unverified. The keys of senders that messaged us are kept
	  in settings (84 bytes each), the least recently verified replaced
	  first, so their
	  messages verify after a sleep or reboot too.

config RET_LXMF_SYNC_LIMIT_KB
	int "Propagation sync: largest batch of messages per request (KB)"
	default 4
	range 1 1000
	help
	  Sent to the node as the per-transfer limit; a batch arrives as one
	  resource, so this must stay below RET_RESOURCE_MAX_SIZE (checked
	  at build time). Messages larger than this are left at the node.

config RET_LXMF_SYNC_MAX_IDS
	int "Propagation sync: message ids held per listing"
	default 32
	range 1 512
	help
	  32 bytes each. A node holding more is listed again after these
	  are fetched.

config RET_LXMF_MAX_FUTURE_S
	int "Largest LXMF timestamp skew ahead of our clock (s)"
	default 3600
	help
	  Messages stamped further in the future are refused: once
	  remembered and evicted, such a timestamp would raise the replay
	  floor above every genuine message.

config RET_LXMF_MAX_AGE_DAYS
	int "Oldest LXMF message accepted (days, by its timestamp)"
	default 30
	range 1 365
	help
	  Older messages are refused as possible replays. Propagation nodes
	  keep messages for 30 days (LXMRouter MESSAGE_EXPIRY). Needs the
	  wall clock; until it is set only the remembered messages apply.

endif # RET_CLIENT
```
